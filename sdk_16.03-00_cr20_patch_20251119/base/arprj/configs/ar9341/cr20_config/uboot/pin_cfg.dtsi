#include <dt-bindings/pinctrl/pinctrl-ar9301.h>

&soc {
	pinctrl {
		compatible = "artosyn,ar9301-pinctrl";
		reg = <0x01073000 0x00000108	// pb_sw_reg_base
		       0x01073130 0x00000060>;	// pad_func_sel_base
		pinctrl-cfgs = <
			(PIN0 | FUNCTION_MODE0 | DRIVING_SELECTOR_2 | PULL_UP | SCHMITT_TRIGGER_DISABLE | SLEW_RATE_DISABLE)  // PIN_B19 RSTN
			(PIN1 | FUNCTION_MODE0 | DRIVING_SELECTOR_2 | PULL_DOWN | SCHMITT_TRIGGER_DISABLE | SLEW_RATE_DISABLE)  // PIN_A19 TEST_MODE_EN
			(PIN2 | FUNCTION_MODE2 | DRIVING_SELECTOR_2 | PULL_DOWN | SCHMITT_TRIGGER_DISABLE | SLEW_RATE_DISABLE)  // PIN_D37 GPIO_A0_0
			(PIN3 | FUNCTION_MODE2 | DRIVING_SELECTOR_2 | PULL_UP | SCHMITT_TRIGGER_DISABLE | SLEW_RATE_DISABLE)  // PIN_C36 GPIO_A0_1
			//camera power
			(PIN4 | FUNCTION_MODE2 | DRIVING_SELECTOR_2 | PULL_DOWN | SCHMITT_TRIGGER_DISABLE | SLEW_RATE_DISABLE)  // PIN_D36 GPIO_A0_2

			(PIN14 | FUNCTION_MODE2 | DRIVING_SELECTOR_2 | PULL_DOWN | SCHMITT_TRIGGER_DISABLE | SLEW_RATE_DISABLE)  // PIN_1D16 GPIO_C0_4
			(PIN15 | FUNCTION_MODE2 | DRIVING_SELECTOR_2 | PULL_DOWN | SCHMITT_TRIGGER_DISABLE | SLEW_RATE_DISABLE)  // PIN_1D15 GPIO_C0_5
			(PIN16 | FUNCTION_MODE2 | DRIVING_SELECTOR_2 | PULL_DOWN | SCHMITT_TRIGGER_DISABLE | SLEW_RATE_DISABLE)  // PIN_1C17 GPIO_C0_6
			(PIN17 | FUNCTION_MODE2 | DRIVING_SELECTOR_2 | PULL_DOWN | SCHMITT_TRIGGER_DISABLE | SLEW_RATE_DISABLE)  // PIN_1B18 GPIO_C0_7
			(PIN18 | FUNCTION_MODE2 | DRIVING_SELECTOR_2 | PULL_DOWN | SCHMITT_TRIGGER_DISABLE | SLEW_RATE_DISABLE)  // PIN_1B17 GPIO_A1_3
			(PIN22 | FUNCTION_MODE5 | DRIVING_SELECTOR_2 | PULL_DOWN | SCHMITT_TRIGGER_DISABLE | SLEW_RATE_DISABLE)  // PIN_1D14 UART_SIN2
			(PIN23 | FUNCTION_MODE5 | DRIVING_SELECTOR_2 | PULL_DOWN | SCHMITT_TRIGGER_DISABLE | SLEW_RATE_DISABLE)  // PIN_1D13 UART_SOUT2
			//camera
			(PIN26 | FUNCTION_MODE6 | DRIVING_SELECTOR_2 | PULL_UP | SCHMITT_TRIGGER_DISABLE | SLEW_RATE_DISABLE)  // PIN_1D11 I2C_SDA0
			(PIN27 | FUNCTION_MODE6 | DRIVING_SELECTOR_2 | PULL_UP | SCHMITT_TRIGGER_DISABLE | SLEW_RATE_DISABLE)  // PIN_1B14 I2C_SCLK0
			(PIN28 | FUNCTION_MODE6 | DRIVING_SELECTOR_2 | PULL_UP | SCHMITT_TRIGGER_DISABLE | SLEW_RATE_DISABLE)  // PIN_1B15 I2C_SDA1
			(PIN29 | FUNCTION_MODE6 | DRIVING_SELECTOR_2 | PULL_UP | SCHMITT_TRIGGER_DISABLE | SLEW_RATE_DISABLE)  // PIN_1C15 I2C_SCLK1
			(PIN30 | FUNCTION_MODE1 | DRIVING_SELECTOR_2 | PULL_DOWN | SCHMITT_TRIGGER_DISABLE | SLEW_RATE_DISABLE)  // PIN_1C12 Sensor_Mclk0
			(PIN31 | FUNCTION_MODE1 | DRIVING_SELECTOR_2 | PULL_DOWN | SCHMITT_TRIGGER_DISABLE | SLEW_RATE_DISABLE)  // PIN_1A14 Sensor_Mclk1
			(PIN38 | FUNCTION_MODE2 | DRIVING_SELECTOR_2 | PULL_DOWN | SCHMITT_TRIGGER_DISABLE | SLEW_RATE_DISABLE)  // PIN_A31 GPIO_C1_0
			(PIN39 | FUNCTION_MODE2 | DRIVING_SELECTOR_2 | PULL_DOWN | SCHMITT_TRIGGER_DISABLE | SLEW_RATE_DISABLE)  // PIN_B30 GPIO_C1_1
			(PIN40 | FUNCTION_MODE3 | DRIVING_SELECTOR_2 | PULL_DOWN | SCHMITT_TRIGGER_DISABLE | SLEW_RATE_DISABLE)  // PIN_B28 UART_SIN1
			(PIN41 | FUNCTION_MODE3 | DRIVING_SELECTOR_2 | PULL_DOWN | SCHMITT_TRIGGER_DISABLE | SLEW_RATE_DISABLE)  // PIN_B29 UART_SOUT1
			(PIN42 | FUNCTION_MODE2 | DRIVING_SELECTOR_2 | PULL_DOWN | SCHMITT_TRIGGER_DISABLE | SLEW_RATE_DISABLE)  // PIN_B26 GPIO_C1_4
			(PIN47 | FUNCTION_MODE3 | DRIVING_SELECTOR_2 | PULL_DOWN | SCHMITT_TRIGGER_DISABLE | SLEW_RATE_DISABLE)  // PIN_A29 UART_CTS_N1
			(PIN48 | FUNCTION_MODE3 | DRIVING_SELECTOR_2 | PULL_DOWN | SCHMITT_TRIGGER_DISABLE | SLEW_RATE_DISABLE)  // PIN_A25 UART_RTS_N1
			(PIN49 | FUNCTION_MODE2 | DRIVING_SELECTOR_2 | PULL_DOWN | SCHMITT_TRIGGER_DISABLE | SLEW_RATE_DISABLE)  // PIN_A26 GPIO_D1_3
			(PIN51 | FUNCTION_MODE4 | DRIVING_SELECTOR_2 | PULL_DOWN | SCHMITT_TRIGGER_DISABLE | SLEW_RATE_DISABLE)  // PIN_AK36 //
			(PIN52 | FUNCTION_MODE0 | DRIVING_SELECTOR_2 | PULL_DOWN | SCHMITT_TRIGGER_DISABLE | SLEW_RATE_DISABLE)  // PIN_AL36 GPIO_D1_6 SOC2USBWIFI_EN
			(PIN54 | FUNCTION_MODE6 | DRIVING_SELECTOR_2 | PULL_DOWN | SCHMITT_TRIGGER_DISABLE | SLEW_RATE_DISABLE)  // PIN_AN36 UART_CTS_N2//
			(PIN65 | FUNCTION_MODE0 | DRIVING_SELECTOR_2 | PULL_DOWN | SCHMITT_TRIGGER_DISABLE | SLEW_RATE_DISABLE)  // PIN_1W16 JTAG_TDI USB_BOOT_EN

			(PIN82 | FUNCTION_MODE0 | DRIVING_SELECTOR_2 | PULL_DOWN | SCHMITT_TRIGGER_DISABLE | SLEW_RATE_DISABLE)  // PIN_B20 QSPI_DATA_2
			(PIN83 | FUNCTION_MODE6 | DRIVING_SELECTOR_2 | PULL_DOWN | SCHMITT_TRIGGER_DISABLE | SLEW_RATE_DISABLE)  // PIN_A20 I2S_SDO_21
			(PIN84 | FUNCTION_MODE6 | DRIVING_SELECTOR_2 | PULL_DOWN | SCHMITT_TRIGGER_DISABLE | SLEW_RATE_DISABLE)  // PIN_1B20 I2S_SDI_22
			(PIN87 | FUNCTION_MODE0 | DRIVING_SELECTOR_2 | PULL_DOWN | SCHMITT_TRIGGER_DISABLE | SLEW_RATE_DISABLE)  // PIN_E36
			//指纹
			(PIN88 | FUNCTION_MODE0 | DRIVING_SELECTOR_2 | PULL_DOWN | SCHMITT_TRIGGER_DISABLE | SLEW_RATE_DISABLE)  // PIN_F36 FP_PWR_EN
			//wifi
			(PIN85 | FUNCTION_MODE2 | DRIVING_SELECTOR_2 | NO_PULL | SCHMITT_TRIGGER_DISABLE | SLEW_RATE_DISABLE)  // PIN_1R20 SDIOWIFI_CLK
			(PIN86 | FUNCTION_MODE2 | DRIVING_SELECTOR_2 | PULL_UP | SCHMITT_TRIGGER_DISABLE | SLEW_RATE_DISABLE)  // PIN_1P20 SDIOWIFI_CMD
			(PIN87 | FUNCTION_MODE2 | DRIVING_SELECTOR_2 | PULL_DOWN | SCHMITT_TRIGGER_DISABLE | SLEW_RATE_DISABLE)  // PIN_E36 SD_CARD_DETECT_N0
			(PIN89 | FUNCTION_MODE2 | DRIVING_SELECTOR_2 | PULL_UP | SCHMITT_TRIGGER_DISABLE | SLEW_RATE_DISABLE)  // PIN_1P19 SDIOWIFI_D0
			(PIN90 | FUNCTION_MODE2 | DRIVING_SELECTOR_2 | PULL_UP | SCHMITT_TRIGGER_DISABLE | SLEW_RATE_DISABLE)  // PIN_1R19 SDIOWIFI_D1
			(PIN91 | FUNCTION_MODE2 | DRIVING_SELECTOR_2 | PULL_UP | SCHMITT_TRIGGER_DISABLE | SLEW_RATE_DISABLE)  // PIN_1R18 SDIOWIFI_D2
			(PIN92 | FUNCTION_MODE2 | DRIVING_SELECTOR_2 | PULL_UP | SCHMITT_TRIGGER_DISABLE | SLEW_RATE_DISABLE)  // PIN_1P18 SDIOWIFI_D3
			(PIN93 | FUNCTION_MODE0 | DRIVING_SELECTOR_2 | PULL_DOWN | SCHMITT_TRIGGER_DISABLE | SLEW_RATE_DISABLE)  // PIN_AG36 WL_REG_ON
			(PIN94 | FUNCTION_MODE0 | DRIVING_SELECTOR_2 | PULL_DOWN | SCHMITT_TRIGGER_DISABLE | SLEW_RATE_DISABLE)  // PIN_AF36 WL_HOST_WAKE
			(PIN127 | FUNCTION_MODE0 | DRIVING_SELECTOR_2 | PULL_DOWN | SCHMITT_TRIGGER_DISABLE | SLEW_RATE_DISABLE)  // PIN_AF36 SOC2USBWIFI_EN
			(PIN95 | FUNCTION_MODE0 | DRIVING_SELECTOR_2 | PULL_DOWN | SCHMITT_TRIGGER_DISABLE | SLEW_RATE_DISABLE)  // PIN_AH36
			(PIN96 | FUNCTION_MODE0 | DRIVING_SELECTOR_2 | PULL_DOWN | SCHMITT_TRIGGER_DISABLE | SLEW_RATE_DISABLE)  // PIN_AH37
			(PIN97 | FUNCTION_MODE0 | DRIVING_SELECTOR_2 | PULL_DOWN | SCHMITT_TRIGGER_DISABLE | SLEW_RATE_DISABLE)  // PIN_AJ36
			(PIN98 | FUNCTION_MODE0 | DRIVING_SELECTOR_2 | PULL_DOWN | SCHMITT_TRIGGER_DISABLE | SLEW_RATE_DISABLE)  // PIN_AJ37
			(PIN99 | FUNCTION_MODE0 | DRIVING_SELECTOR_2 | PULL_UP | SCHMITT_TRIGGER_DISABLE | SLEW_RATE_DISABLE)  // PIN_G37 GPIO_A3_5 TOUCH_INT
			(PIN100 | FUNCTION_MODE0 | DRIVING_SELECTOR_2 | PULL_DOWN | SCHMITT_TRIGGER_DISABLE | SLEW_RATE_DISABLE)  // PIN_G36
			(PIN101 | FUNCTION_MODE0 | DRIVING_SELECTOR_2 | PULL_DOWN | SCHMITT_TRIGGER_DISABLE | SLEW_RATE_DISABLE)  // PIN_1C20
			(PIN102 | FUNCTION_MODE0 | DRIVING_SELECTOR_2 | PULL_DOWN | SCHMITT_TRIGGER_DISABLE | SLEW_RATE_DISABLE)  // PIN_1V20
			(PIN103 | FUNCTION_MODE0 | DRIVING_SELECTOR_2 | PULL_DOWN | SCHMITT_TRIGGER_DISABLE | SLEW_RATE_DISABLE)  // PIN_1W20
			(PIN104 | FUNCTION_MODE0 | DRIVING_SELECTOR_2 | PULL_DOWN | SCHMITT_TRIGGER_DISABLE | SLEW_RATE_DISABLE)  // PIN_1U20
			(PIN105 | FUNCTION_MODE0 | DRIVING_SELECTOR_2 | PULL_DOWN | SCHMITT_TRIGGER_DISABLE | SLEW_RATE_DISABLE)  // PIN_1U19
			(PIN106 | FUNCTION_MODE0 | DRIVING_SELECTOR_2 | PULL_DOWN | SCHMITT_TRIGGER_DISABLE | SLEW_RATE_DISABLE)  // PIN_1V19
			(PIN107 | FUNCTION_MODE0 | DRIVING_SELECTOR_2 | PULL_DOWN | SCHMITT_TRIGGER_DISABLE | SLEW_RATE_DISABLE)  // PIN_1U18
			(PIN108 | FUNCTION_MODE0 | DRIVING_SELECTOR_2 | PULL_DOWN | SCHMITT_TRIGGER_DISABLE | SLEW_RATE_DISABLE)  // PIN_H36 LEDR_CTL
			(PIN109 | FUNCTION_MODE0 | DRIVING_SELECTOR_2 | PULL_DOWN | SCHMITT_TRIGGER_DISABLE | SLEW_RATE_DISABLE)  // PIN_1C19 LEDG_CTL
			(PIN110 | FUNCTION_MODE0 | DRIVING_SELECTOR_2 | PULL_DOWN | SCHMITT_TRIGGER_DISABLE | SLEW_RATE_DISABLE)  // PIN_H37 LEDB_CTL

			(PIN111 | FUNCTION_MODE2 | DRIVING_SELECTOR_2 | PULL_UP | SCHMITT_TRIGGER_DISABLE | SLEW_RATE_DISABLE)  // PIN_AG2 EMMC0
			(PIN112 | FUNCTION_MODE2 | DRIVING_SELECTOR_2 | PULL_UP | SCHMITT_TRIGGER_DISABLE | SLEW_RATE_DISABLE)  // PIN_AG1 EMMC0
			(PIN113 | FUNCTION_MODE2 | DRIVING_SELECTOR_2 | PULL_UP | SCHMITT_TRIGGER_DISABLE | SLEW_RATE_DISABLE)  // PIN_1R2 EMMC0
			(PIN114 | FUNCTION_MODE2 | DRIVING_SELECTOR_2 | PULL_UP | SCHMITT_TRIGGER_DISABLE | SLEW_RATE_DISABLE)  // PIN_AH1 EMMC0
			(PIN115 | FUNCTION_MODE2 | DRIVING_SELECTOR_2 | PULL_UP | SCHMITT_TRIGGER_DISABLE | SLEW_RATE_DISABLE)  // PIN_AH2 EMMC0
			(PIN116 | FUNCTION_MODE2 | DRIVING_SELECTOR_2 | PULL_UP | SCHMITT_TRIGGER_DISABLE | SLEW_RATE_DISABLE)  // PIN_1R3 EMMC0
			(PIN117 | FUNCTION_MODE2 | DRIVING_SELECTOR_2 | PULL_UP | SCHMITT_TRIGGER_DISABLE | SLEW_RATE_DISABLE)  // PIN_1U1 EMMC0
			(PIN118 | FUNCTION_MODE2 | DRIVING_SELECTOR_2 | PULL_UP | SCHMITT_TRIGGER_DISABLE | SLEW_RATE_DISABLE)  // PIN_1V1 EMMC0
			(PIN119 | FUNCTION_MODE2 | DRIVING_SELECTOR_2 | PULL_UP | SCHMITT_TRIGGER_DISABLE | SLEW_RATE_DISABLE)  // PIN_1U3 EMMC0
			(PIN120 | FUNCTION_MODE2 | DRIVING_SELECTOR_2 | PULL_UP | SCHMITT_TRIGGER_DISABLE | SLEW_RATE_DISABLE)  // PIN_1V2 EMMC0
			(PIN121 | FUNCTION_MODE2 | DRIVING_SELECTOR_2 | PULL_UP | SCHMITT_TRIGGER_DISABLE | SLEW_RATE_DISABLE)  // PIN_1U2 EMMC0

			(PIN123 | FUNCTION_MODE0 | DRIVING_SELECTOR_2 | PULL_UP | SCHMITT_TRIGGER_DISABLE | SLEW_RATE_DISABLE)  // PIN_1E17 GPIO_B1_1 usb_otg
			(PIN124 | FUNCTION_MODE0 | DRIVING_SELECTOR_2 | PULL_UP | SCHMITT_TRIGGER_DISABLE | SLEW_RATE_DISABLE)  // PIN_1F17 GPIO_B1_2 usb_otg
			(PIN125 | FUNCTION_MODE0 | DRIVING_SELECTOR_2 | PULL_UP | SCHMITT_TRIGGER_DISABLE | SLEW_RATE_DISABLE)  // PIN_1E18 GPIO_B1_3 usb_otg

			(PIN126 | FUNCTION_MODE4 | DRIVING_SELECTOR_2 | PULL_DOWN | SCHMITT_TRIGGER_DISABLE | SLEW_RATE_DISABLE)  // PIN_1F19 GPIO_C0_3
			(PIN128 | FUNCTION_MODE4 | DRIVING_SELECTOR_2 | PULL_DOWN | SCHMITT_TRIGGER_DISABLE | SLEW_RATE_DISABLE)  // PIN_L37 GPIO_D1_5
			(PIN129 | FUNCTION_MODE0 | DRIVING_SELECTOR_2 | PULL_DOWN | SCHMITT_TRIGGER_DISABLE | SLEW_RATE_DISABLE)  // PIN_M36 GPIO_B1_7 TOUCH_RST
			(PIN130 | FUNCTION_MODE2 | DRIVING_SELECTOR_2 | PULL_DOWN | SCHMITT_TRIGGER_DISABLE | SLEW_RATE_DISABLE)  // PIN_N36 I2S_CLK_1//
			(PIN131 | FUNCTION_MODE2 | DRIVING_SELECTOR_2 | PULL_DOWN | SCHMITT_TRIGGER_DISABLE | SLEW_RATE_DISABLE)  // PIN_N37 I2S_SDI_11//
			(PIN133 | FUNCTION_MODE1 | DRIVING_SELECTOR_2 | PULL_UP | SCHMITT_TRIGGER_DISABLE | SLEW_RATE_DISABLE)  // PIN_P37 I2C_SDA3
			(PIN134 | FUNCTION_MODE1 | DRIVING_SELECTOR_2 | PULL_UP | SCHMITT_TRIGGER_DISABLE | SLEW_RATE_DISABLE)  // PIN_1J18 I2C_SCLK3
			(PIN137 | FUNCTION_MODE6 | DRIVING_SELECTOR_2 | PULL_DOWN | SCHMITT_TRIGGER_DISABLE | SLEW_RATE_DISABLE)  // PIN_1H19 PWM7
			// (PIN139 | FUNCTION_MODE6 | DRIVING_SELECTOR_2 | PULL_DOWN | SCHMITT_TRIGGER_DISABLE | SLEW_RATE_DISABLE)  // PIN_1H20 PWM9
			(PIN140 | FUNCTION_MODE1 | DRIVING_SELECTOR_2 | PULL_DOWN | SCHMITT_TRIGGER_DISABLE | SLEW_RATE_DISABLE)  // PIN_A23 SPI_M1_SCLK
			(PIN141 | FUNCTION_MODE1 | DRIVING_SELECTOR_2 | PULL_DOWN | SCHMITT_TRIGGER_DISABLE | SLEW_RATE_DISABLE)  // PIN_A22 SPI_M1_CS0N
			(PIN142 | FUNCTION_MODE1 | DRIVING_SELECTOR_2 | PULL_DOWN | SCHMITT_TRIGGER_DISABLE | SLEW_RATE_DISABLE)  // PIN_B22 SPI_M1_DI
			(PIN143 | FUNCTION_MODE1 | DRIVING_SELECTOR_2 | PULL_DOWN | SCHMITT_TRIGGER_DISABLE | SLEW_RATE_DISABLE)  // PIN_B21 SPI_M1_DO
			//(PIN144 | FUNCTION_MODE6 | DRIVING_SELECTOR_2 | PULL_DOWN | SCHMITT_TRIGGER_DISABLE | SLEW_RATE_DISABLE)  // PIN_T36 PWM0
			(PIN144 | FUNCTION_MODE0 | DRIVING_SELECTOR_2 | PULL_DOWN | SCHMITT_TRIGGER_DISABLE | SLEW_RATE_DISABLE)  // PIN_T36 GPIO_D3_4
			(PIN145 | FUNCTION_MODE0 | DRIVING_SELECTOR_2 | PULL_DOWN | SCHMITT_TRIGGER_DISABLE | SLEW_RATE_DISABLE)  // PIN_1D18 GPIO_D3_5 WG0
			(PIN146 | FUNCTION_MODE0 | DRIVING_SELECTOR_2 | PULL_DOWN | SCHMITT_TRIGGER_DISABLE | SLEW_RATE_DISABLE)  // PIN_1F18 GPIO_D3_6 WG1
			(PIN151 | FUNCTION_MODE0 | DRIVING_SELECTOR_2 | PULL_DOWN | SCHMITT_TRIGGER_DISABLE | SLEW_RATE_DISABLE)  // PIN_U36 GPIO_D2_3 -> I2C_SDA0
			(PIN152 | FUNCTION_MODE0 | DRIVING_SELECTOR_2 | PULL_DOWN | SCHMITT_TRIGGER_DISABLE | SLEW_RATE_DISABLE)  // PIN_V36 GPIO_D2_4 -> I2C_SCLK0
			//电平转换电路
			(PIN156 | FUNCTION_MODE0 | DRIVING_SELECTOR_2 | PULL_DOWN | SCHMITT_TRIGGER_DISABLE | SLEW_RATE_DISABLE)  // PIN_Y37 GPIO_D0_0 SOC_RST
			//debug
			(PIN159 | FUNCTION_MODE0 | DRIVING_SELECTOR_2 | PULL_DOWN | SCHMITT_TRIGGER_DISABLE | SLEW_RATE_DISABLE)  // PIN_1L20 UART_SIN0
			(PIN160 | FUNCTION_MODE0 | DRIVING_SELECTOR_2 | PULL_DOWN | SCHMITT_TRIGGER_DISABLE | SLEW_RATE_DISABLE)  // PIN_1M20 UART_SOUT0
			// (PIN162 | FUNCTION_MODE0 | DRIVING_SELECTOR_2 | PULL_DOWN | SCHMITT_TRIGGER_DISABLE | SLEW_RATE_DISABLE)  // PIN_1L19
			(PIN163 | FUNCTION_MODE2 | DRIVING_SELECTOR_2 | PULL_DOWN | SCHMITT_TRIGGER_DISABLE | SLEW_RATE_DISABLE)  // PIN_1L18 UART_SIN3
			(PIN164 | FUNCTION_MODE2 | DRIVING_SELECTOR_2 | PULL_DOWN | SCHMITT_TRIGGER_DISABLE | SLEW_RATE_DISABLE)  // PIN_1M19 UART_SOUT3
			(PIN165 | FUNCTION_MODE2 | DRIVING_SELECTOR_2 | PULL_DOWN | SCHMITT_TRIGGER_DISABLE | SLEW_RATE_DISABLE)  // PIN_1M18 UART_SIN4
			(PIN166 | FUNCTION_MODE2 | DRIVING_SELECTOR_2 | PULL_DOWN | SCHMITT_TRIGGER_DISABLE | SLEW_RATE_DISABLE)  // PIN_AB37 UART_SOUT4
			// (PIN168 | FUNCTION_MODE0 | DRIVING_SELECTOR_2 | PULL_DOWN | SCHMITT_TRIGGER_DISABLE | SLEW_RATE_DISABLE)  // PIN_AC37
			//RS485
			(PIN171 | FUNCTION_MODE0 | DRIVING_SELECTOR_2 | PULL_DOWN | SCHMITT_TRIGGER_DISABLE | SLEW_RATE_DISABLE)  // PIN_1E20 GPIO_D0_5
			(PIN175 | FUNCTION_MODE2 | DRIVING_SELECTOR_2 | PULL_DOWN | SCHMITT_TRIGGER_DISABLE | SLEW_RATE_DISABLE)  // PIN_1P2 GBE_TXC
			(PIN176 | FUNCTION_MODE2 | DRIVING_SELECTOR_2 | PULL_DOWN | SCHMITT_TRIGGER_DISABLE | SLEW_RATE_DISABLE)  // PIN_1R1 GBE_TXEN
			(PIN177 | FUNCTION_MODE2 | DRIVING_SELECTOR_2 | PULL_DOWN | SCHMITT_TRIGGER_DISABLE | SLEW_RATE_DISABLE)  // PIN_1P1 GBE_TXD0
			(PIN178 | FUNCTION_MODE2 | DRIVING_SELECTOR_2 | PULL_DOWN | SCHMITT_TRIGGER_DISABLE | SLEW_RATE_DISABLE)  // PIN_AF2 GBE_TXD1
			(PIN179 | FUNCTION_MODE2 | DRIVING_SELECTOR_2 | PULL_DOWN | SCHMITT_TRIGGER_DISABLE | SLEW_RATE_DISABLE)  // PIN_AE2 GBE_TXD2
			(PIN180 | FUNCTION_MODE2 | DRIVING_SELECTOR_2 | PULL_DOWN | SCHMITT_TRIGGER_DISABLE | SLEW_RATE_DISABLE)  // PIN_AE1 GBE_TXD3
			(PIN181 | FUNCTION_MODE2 | DRIVING_SELECTOR_2 | PULL_DOWN | SCHMITT_TRIGGER_DISABLE | SLEW_RATE_DISABLE)  // PIN_1M3 GBE_RXC
			(PIN182 | FUNCTION_MODE2 | DRIVING_SELECTOR_2 | PULL_DOWN | SCHMITT_TRIGGER_DISABLE | SLEW_RATE_DISABLE)  // PIN_1M2 GBE_RXDV
			(PIN183 | FUNCTION_MODE2 | DRIVING_SELECTOR_2 | PULL_DOWN | SCHMITT_TRIGGER_DISABLE | SLEW_RATE_DISABLE)  // PIN_AD2 GBE_RXD0
			(PIN184 | FUNCTION_MODE2 | DRIVING_SELECTOR_2 | PULL_DOWN | SCHMITT_TRIGGER_DISABLE | SLEW_RATE_DISABLE)  // PIN_AD1 GBE_RXD1
			(PIN185 | FUNCTION_MODE2 | DRIVING_SELECTOR_2 | PULL_DOWN | SCHMITT_TRIGGER_DISABLE | SLEW_RATE_DISABLE)  // PIN_1M1 GBE_RXD2
			(PIN186 | FUNCTION_MODE2 | DRIVING_SELECTOR_2 | PULL_DOWN | SCHMITT_TRIGGER_DISABLE | SLEW_RATE_DISABLE)  // PIN_AC2 GBE_RXD3
			(PIN187 | FUNCTION_MODE2 | DRIVING_SELECTOR_2 | PULL_DOWN | SCHMITT_TRIGGER_DISABLE | SLEW_RATE_DISABLE)  // PIN_AB2 GBE_MDC
			(PIN188 | FUNCTION_MODE2 | DRIVING_SELECTOR_2 | PULL_DOWN | SCHMITT_TRIGGER_DISABLE | SLEW_RATE_DISABLE)  // PIN_AB1 GBE_MDIO
			(PIN189 | FUNCTION_MODE2 | DRIVING_SELECTOR_2 | PULL_DOWN | SCHMITT_TRIGGER_DISABLE | SLEW_RATE_DISABLE)  // PIN_AA2 GBE_INT
			(PIN190 | FUNCTION_MODE2 | DRIVING_SELECTOR_2 | PULL_DOWN | SCHMITT_TRIGGER_DISABLE | SLEW_RATE_DISABLE)  // PIN_Y2  GBE_CLK
			(PIN191 | FUNCTION_MODE2 | DRIVING_SELECTOR_2 | PULL_DOWN | SCHMITT_TRIGGER_DISABLE | SLEW_RATE_DISABLE)  // PIN_AA1 GBE_RSTN
			(PIN192 | FUNCTION_MODE0 | DRIVING_SELECTOR_2 | PULL_DOWN | SCHMITT_TRIGGER_DISABLE | SLEW_RATE_DISABLE)  // PIN_AE37 JTAG_TD0
		>;
		pb-msc-cfgs = <
			(PB_MSC_BIT0  | PB_MSC_REG_PIN_V18)  // PB085_086, PB089_092
			(PB_MSC_BIT1  | PB_MSC_REG_PIN_V18)  // PB093_098
			(PB_MSC_BIT2  | PB_MSC_REG_PIN_V18)  // PB102_107
			(PB_MSC_BIT3  | PB_MSC_REG_PIN_V33)  // PB111_116
			(PB_MSC_BIT4  | PB_MSC_REG_PIN_V33)  // PB117_121
			(PB_MSC_BIT5  | PB_MSC_REG_PIN_V33)  // PB002_025
			(PB_MSC_BIT6  | PB_MSC_REG_PIN_V18)  // PB026_049
			(PB_MSC_BIT7  | PB_MSC_REG_PIN_V33)  // PB050_081
			(PB_MSC_BIT8  | PB_MSC_REG_PIN_V33)  // PB082_083, PB140_143
			(PB_MSC_BIT9  | PB_MSC_REG_PIN_V33)  // PB084, PB087_088, PB099_101, PB108_110, PB122_139, PB144_174, PB192
			(PB_MSC_BIT10 | PB_MSC_REG_PIN_V33)  // PB175_191
		>;
	};
};
