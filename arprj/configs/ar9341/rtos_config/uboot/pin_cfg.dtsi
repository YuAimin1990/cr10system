#include <dt-bindings/pinctrl/pinctrl-ar9301.h>

&soc {
	pinctrl {
		compatible = "artosyn,ar9301-pinctrl";
		reg = <0x01073000 0x00000108	// pb_sw_reg_base
		       0x01073130 0x00000060>;	// pad_func_sel_base
		pinctrl-cfgs = <
			(PIN2 | FUNCTION_MODE0 | DRIVING_SELECTOR_2 | PULL_DOWN | SCHMITT_TRIGGER_DISABLE | SLEW_RATE_DISABLE)
			(PIN3 | FUNCTION_MODE0 | DRIVING_SELECTOR_2 | PULL_DOWN | SCHMITT_TRIGGER_DISABLE | SLEW_RATE_DISABLE)
			(PIN4 | FUNCTION_MODE0 | DRIVING_SELECTOR_2 | PULL_DOWN | SCHMITT_TRIGGER_DISABLE | SLEW_RATE_DISABLE)
			(PIN5 | FUNCTION_MODE0 | DRIVING_SELECTOR_2 | PULL_DOWN | SCHMITT_TRIGGER_DISABLE | SLEW_RATE_DISABLE)  // PIN_B36 I2S0
			(PIN6 | FUNCTION_MODE0 | DRIVING_SELECTOR_2 | PULL_DOWN | SCHMITT_TRIGGER_DISABLE | SLEW_RATE_DISABLE)  // PIN_B37 DVPA-IN
			(PIN7 | FUNCTION_MODE0 | DRIVING_SELECTOR_2 | PULL_DOWN | SCHMITT_TRIGGER_DISABLE | SLEW_RATE_DISABLE)  // PIN_A35 DVPA-IN
			(PIN8 | FUNCTION_MODE0 | DRIVING_SELECTOR_2 | PULL_DOWN | SCHMITT_TRIGGER_DISABLE | SLEW_RATE_DISABLE)  // PIN_B35 DVPA-IN
			(PIN9 | FUNCTION_MODE0 | DRIVING_SELECTOR_2 | PULL_DOWN | SCHMITT_TRIGGER_DISABLE | SLEW_RATE_DISABLE)  // PIN_A34 DVPA-IN
			(PIN10 | FUNCTION_MODE0 | DRIVING_SELECTOR_2 | PULL_DOWN | SCHMITT_TRIGGER_DISABLE | SLEW_RATE_DISABLE)  // PIN_B34 DVPA-IN
			(PIN11 | FUNCTION_MODE0 | DRIVING_SELECTOR_2 | PULL_DOWN | SCHMITT_TRIGGER_DISABLE | SLEW_RATE_DISABLE)  // PIN_B32 DVPA-IN
			(PIN12 | FUNCTION_MODE0 | DRIVING_SELECTOR_2 | PULL_DOWN | SCHMITT_TRIGGER_DISABLE | SLEW_RATE_DISABLE)  // PIN_B33 DVPA-IN
			(PIN13 | FUNCTION_MODE0 | DRIVING_SELECTOR_2 | PULL_DOWN | SCHMITT_TRIGGER_DISABLE | SLEW_RATE_DISABLE)  // PIN_A32 DVPA-IN
			(PIN14 | FUNCTION_MODE0 | DRIVING_SELECTOR_2 | PULL_DOWN | SCHMITT_TRIGGER_DISABLE | SLEW_RATE_DISABLE)  // PIN_1D16 DVPA-IN
			(PIN15 | FUNCTION_MODE0 | DRIVING_SELECTOR_2 | PULL_DOWN | SCHMITT_TRIGGER_DISABLE | SLEW_RATE_DISABLE)  // PIN_1D15 DVPA-IN
			(PIN16 | FUNCTION_MODE0 | DRIVING_SELECTOR_2 | PULL_DOWN | SCHMITT_TRIGGER_DISABLE | SLEW_RATE_DISABLE)  // PIN_1C17 DVPA-IN
			(PIN17 | FUNCTION_MODE0 | DRIVING_SELECTOR_2 | PULL_DOWN | SCHMITT_TRIGGER_DISABLE | SLEW_RATE_DISABLE)  // PIN_1B18 DVPA-IN
			(PIN18 | FUNCTION_MODE0 | DRIVING_SELECTOR_2 | PULL_DOWN | SCHMITT_TRIGGER_DISABLE | SLEW_RATE_DISABLE)
			(PIN19 | FUNCTION_MODE0 | DRIVING_SELECTOR_2 | PULL_DOWN | SCHMITT_TRIGGER_DISABLE | SLEW_RATE_DISABLE)
			(PIN20 | FUNCTION_MODE0 | DRIVING_SELECTOR_2 | PULL_DOWN | SCHMITT_TRIGGER_DISABLE | SLEW_RATE_DISABLE)
			(PIN21 | FUNCTION_MODE0 | DRIVING_SELECTOR_2 | PULL_DOWN | SCHMITT_TRIGGER_DISABLE | SLEW_RATE_DISABLE)
			(PIN22 | FUNCTION_MODE0 | DRIVING_SELECTOR_2 | PULL_DOWN | SCHMITT_TRIGGER_DISABLE | SLEW_RATE_DISABLE)
			(PIN23 | FUNCTION_MODE2 | DRIVING_SELECTOR_2 | PULL_DOWN | SCHMITT_TRIGGER_DISABLE | SLEW_RATE_DISABLE)
			(PIN24 | FUNCTION_MODE2 | DRIVING_SELECTOR_2 | PULL_DOWN | SCHMITT_TRIGGER_DISABLE | SLEW_RATE_DISABLE)
			(PIN25 | FUNCTION_MODE2 | DRIVING_SELECTOR_2 | PULL_DOWN | SCHMITT_TRIGGER_DISABLE | SLEW_RATE_DISABLE)
			(PIN42 | FUNCTION_MODE4 | DRIVING_SELECTOR_2 | PULL_DOWN | SCHMITT_TRIGGER_DISABLE | SLEW_RATE_DISABLE)  // PIN_B26 SPI-S0
			(PIN43 | FUNCTION_MODE4 | DRIVING_SELECTOR_2 | PULL_DOWN | SCHMITT_TRIGGER_DISABLE | SLEW_RATE_DISABLE)  // PIN_B27 SPI-S0
			(PIN44 | FUNCTION_MODE4 | DRIVING_SELECTOR_2 | PULL_DOWN | SCHMITT_TRIGGER_DISABLE | SLEW_RATE_DISABLE)  // PIN_B25 SPI-S0
			(PIN45 | FUNCTION_MODE4 | DRIVING_SELECTOR_2 | PULL_DOWN | SCHMITT_TRIGGER_DISABLE | SLEW_RATE_DISABLE)  // PIN_B24 SPI-S0
			(PIN50 | FUNCTION_MODE2 | DRIVING_SELECTOR_2 | PULL_DOWN | SCHMITT_TRIGGER_DISABLE | SLEW_RATE_DISABLE)  // PIN_AL37 DVPC-OUT
			(PIN51 | FUNCTION_MODE2 | DRIVING_SELECTOR_2 | PULL_DOWN | SCHMITT_TRIGGER_DISABLE | SLEW_RATE_DISABLE)  // PIN_AK36 DVPC-OUT
			(PIN52 | FUNCTION_MODE2 | DRIVING_SELECTOR_2 | PULL_DOWN | SCHMITT_TRIGGER_DISABLE | SLEW_RATE_DISABLE)  // PIN_AL36 DVPC-OUT
			(PIN53 | FUNCTION_MODE2 | DRIVING_SELECTOR_2 | PULL_DOWN | SCHMITT_TRIGGER_DISABLE | SLEW_RATE_DISABLE)  // PIN_AM36 DVPC-OUT
			(PIN54 | FUNCTION_MODE2 | DRIVING_SELECTOR_2 | PULL_DOWN | SCHMITT_TRIGGER_DISABLE | SLEW_RATE_DISABLE)  // PIN_AN36 DVPC-OUT
			(PIN55 | FUNCTION_MODE2 | DRIVING_SELECTOR_2 | PULL_DOWN | SCHMITT_TRIGGER_DISABLE | SLEW_RATE_DISABLE)  // PIN_AP36 DVPC-OUT
			(PIN56 | FUNCTION_MODE2 | DRIVING_SELECTOR_2 | PULL_DOWN | SCHMITT_TRIGGER_DISABLE | SLEW_RATE_DISABLE)  // PIN_AM37 DVPC-OUT
			(PIN57 | FUNCTION_MODE2 | DRIVING_SELECTOR_2 | PULL_DOWN | SCHMITT_TRIGGER_DISABLE | SLEW_RATE_DISABLE)  // PIN_AR37 DVPC-OUT
			(PIN58 | FUNCTION_MODE2 | DRIVING_SELECTOR_2 | PULL_DOWN | SCHMITT_TRIGGER_DISABLE | SLEW_RATE_DISABLE)  // PIN_AP37 DVPC-OUT
			(PIN59 | FUNCTION_MODE2 | DRIVING_SELECTOR_2 | PULL_DOWN | SCHMITT_TRIGGER_DISABLE | SLEW_RATE_DISABLE)  // PIN_1W18 DVPC-OUT
			(PIN60 | FUNCTION_MODE2 | DRIVING_SELECTOR_2 | PULL_DOWN | SCHMITT_TRIGGER_DISABLE | SLEW_RATE_DISABLE)  // PIN_AR36 DVPC-OUT
			(PIN61 | FUNCTION_MODE2 | DRIVING_SELECTOR_2 | PULL_DOWN | SCHMITT_TRIGGER_DISABLE | SLEW_RATE_DISABLE)  // PIN_1Y17 DVPC-OUT
			(PIN62 | FUNCTION_MODE6 | DRIVING_SELECTOR_2 | PULL_DOWN | SCHMITT_TRIGGER_DISABLE | SLEW_RATE_DISABLE)  // PIN_1W17 CEVA-UART0
			(PIN63 | FUNCTION_MODE0 | DRIVING_SELECTOR_2 | PULL_DOWN | SCHMITT_TRIGGER_DISABLE | SLEW_RATE_DISABLE)  // PIN_1Y13 JTAG0
			(PIN64 | FUNCTION_MODE0 | DRIVING_SELECTOR_2 | PULL_DOWN | SCHMITT_TRIGGER_DISABLE | SLEW_RATE_DISABLE)  // PIN_1V16 JTAG0
			(PIN66 | FUNCTION_MODE2 | DRIVING_SELECTOR_2 | PULL_DOWN | SCHMITT_TRIGGER_DISABLE | SLEW_RATE_DISABLE)  // PIN_1W14 DVPC-OUT
			(PIN67 | FUNCTION_MODE2 | DRIVING_SELECTOR_2 | PULL_DOWN | SCHMITT_TRIGGER_DISABLE | SLEW_RATE_DISABLE)  // PIN_1W13 DVPC-OUT
			(PIN68 | FUNCTION_MODE2 | DRIVING_SELECTOR_2 | PULL_DOWN | SCHMITT_TRIGGER_DISABLE | SLEW_RATE_DISABLE)  // PIN_1V14 DVPC-OUT
			(PIN69 | FUNCTION_MODE2 | DRIVING_SELECTOR_2 | PULL_DOWN | SCHMITT_TRIGGER_DISABLE | SLEW_RATE_DISABLE)  // PIN_1Y11 DVPC-OUT
			(PIN70 | FUNCTION_MODE2 | DRIVING_SELECTOR_2 | PULL_DOWN | SCHMITT_TRIGGER_DISABLE | SLEW_RATE_DISABLE)  // PIN_1Y10 DVPC-OUT
			(PIN71 | FUNCTION_MODE2 | DRIVING_SELECTOR_2 | PULL_DOWN | SCHMITT_TRIGGER_DISABLE | SLEW_RATE_DISABLE)  // PIN_1W11 DVPC-OUT
			(PIN72 | FUNCTION_MODE2 | DRIVING_SELECTOR_2 | PULL_DOWN | SCHMITT_TRIGGER_DISABLE | SLEW_RATE_DISABLE)  // PIN_1V13 DVPC-OUT
			(PIN73 | FUNCTION_MODE2 | DRIVING_SELECTOR_2 | PULL_DOWN | SCHMITT_TRIGGER_DISABLE | SLEW_RATE_DISABLE)  // PIN_1V11 DVPC-OUT
			(PIN83 | FUNCTION_MODE2 | DRIVING_SELECTOR_2 | PULL_DOWN | SCHMITT_TRIGGER_DISABLE | SLEW_RATE_DISABLE)  // PIN_A20 I2S0


			(PIN99 | FUNCTION_MODE5 | DRIVING_SELECTOR_2 | PULL_DOWN | SCHMITT_TRIGGER_DISABLE | SLEW_RATE_DISABLE)  // PIN_G37 UART3
#ifdef AR_FEAT_EIS
			(PIN100 | FUNCTION_MODE0 | DRIVING_SELECTOR_2 | PULL_DOWN | SCHMITT_TRIGGER_DISABLE | SLEW_RATE_DISABLE)  // PIN_G36 UART3
#else
			(PIN100 | FUNCTION_MODE5 | DRIVING_SELECTOR_2 | PULL_DOWN | SCHMITT_TRIGGER_DISABLE | SLEW_RATE_DISABLE)  // PIN_G36 UART3
#endif
			(PIN111 | FUNCTION_MODE2 | DRIVING_SELECTOR_2 | NO_PULL | SCHMITT_TRIGGER_DISABLE | SLEW_RATE_DISABLE)  // PIN_AG2 EMMC0
			(PIN112 | FUNCTION_MODE2 | DRIVING_SELECTOR_2 | PULL_UP | SCHMITT_TRIGGER_DISABLE | SLEW_RATE_DISABLE)  // PIN_AG1 EMMC0
			(PIN113 | FUNCTION_MODE2 | DRIVING_SELECTOR_2 | NO_PULL | SCHMITT_TRIGGER_DISABLE | SLEW_RATE_DISABLE)  // PIN_1R2 EMMC0
			(PIN114 | FUNCTION_MODE2 | DRIVING_SELECTOR_2 | PULL_UP | SCHMITT_TRIGGER_DISABLE | SLEW_RATE_DISABLE)  // PIN_AH1 EMMC0
			(PIN115 | FUNCTION_MODE2 | DRIVING_SELECTOR_2 | PULL_UP | SCHMITT_TRIGGER_DISABLE | SLEW_RATE_DISABLE)  // PIN_AH2 EMMC0
			(PIN116 | FUNCTION_MODE2 | DRIVING_SELECTOR_2 | PULL_UP | SCHMITT_TRIGGER_DISABLE | SLEW_RATE_DISABLE)  // PIN_1R3 EMMC0
			(PIN117 | FUNCTION_MODE2 | DRIVING_SELECTOR_2 | PULL_UP | SCHMITT_TRIGGER_DISABLE | SLEW_RATE_DISABLE)  // PIN_1U1 EMMC0
			(PIN118 | FUNCTION_MODE2 | DRIVING_SELECTOR_2 | PULL_UP | SCHMITT_TRIGGER_DISABLE | SLEW_RATE_DISABLE)  // PIN_1V1 EMMC0
			(PIN119 | FUNCTION_MODE2 | DRIVING_SELECTOR_2 | PULL_UP | SCHMITT_TRIGGER_DISABLE | SLEW_RATE_DISABLE)  // PIN_1U3 EMMC0
			(PIN120 | FUNCTION_MODE2 | DRIVING_SELECTOR_2 | PULL_UP | SCHMITT_TRIGGER_DISABLE | SLEW_RATE_DISABLE)  // PIN_1V2 EMMC0
			(PIN121 | FUNCTION_MODE2 | DRIVING_SELECTOR_2 | PULL_UP | SCHMITT_TRIGGER_DISABLE | SLEW_RATE_DISABLE)  // PIN_1U2 EMMC0
			(PIN122 | FUNCTION_MODE2 | DRIVING_SELECTOR_2 | NO_PULL | SCHMITT_TRIGGER_DISABLE | SLEW_RATE_DISABLE)  // PIN_1U2 EMMC0
#ifdef AR_FEAT_EIS
			(PIN123 | FUNCTION_MODE0 | DRIVING_SELECTOR_2 | PULL_DOWN | SCHMITT_TRIGGER_DISABLE | SLEW_RATE_DISABLE)  // PIN_1E17 I2S0
			(PIN125 | FUNCTION_MODE0 | DRIVING_SELECTOR_2 | PULL_DOWN | SCHMITT_TRIGGER_DISABLE | SLEW_RATE_DISABLE)  // PIN_1E18 I2S0
			(PIN126 | FUNCTION_MODE0 | DRIVING_SELECTOR_2 | PULL_DOWN | SCHMITT_TRIGGER_DISABLE | SLEW_RATE_DISABLE)  // PIN_1F19 I2S0
#else
			(PIN123 | FUNCTION_MODE2 | DRIVING_SELECTOR_2 | PULL_DOWN | SCHMITT_TRIGGER_DISABLE | SLEW_RATE_DISABLE)  // PIN_1E17 I2S0
			(PIN125 | FUNCTION_MODE2 | DRIVING_SELECTOR_2 | PULL_DOWN | SCHMITT_TRIGGER_DISABLE | SLEW_RATE_DISABLE)  // PIN_1E18 I2S0
			(PIN126 | FUNCTION_MODE2 | DRIVING_SELECTOR_2 | PULL_DOWN | SCHMITT_TRIGGER_DISABLE | SLEW_RATE_DISABLE)  // PIN_1F19 I2S0
#endif
			(PIN133 | FUNCTION_MODE6 | DRIVING_SELECTOR_2 | PULL_DOWN | SCHMITT_TRIGGER_DISABLE | SLEW_RATE_DISABLE)  // PIN_P37 PWM3
			(PIN134 | FUNCTION_MODE6 | DRIVING_SELECTOR_2 | PULL_DOWN | SCHMITT_TRIGGER_DISABLE | SLEW_RATE_DISABLE)  // PIN_1J18 PWM4
			(PIN135 | FUNCTION_MODE6 | DRIVING_SELECTOR_2 | PULL_DOWN | SCHMITT_TRIGGER_DISABLE | SLEW_RATE_DISABLE)  // PIN_1H18 PWM5
			(PIN136 | FUNCTION_MODE6 | DRIVING_SELECTOR_2 | PULL_DOWN | SCHMITT_TRIGGER_DISABLE | SLEW_RATE_DISABLE)  // PIN_1J19 PWM6
			(PIN137 | FUNCTION_MODE1 | DRIVING_SELECTOR_2 | PULL_DOWN | SCHMITT_TRIGGER_DISABLE | SLEW_RATE_DISABLE)  // PIN_1H19 SENSOR-MCLK0
			(PIN138 | FUNCTION_MODE1 | DRIVING_SELECTOR_2 | PULL_DOWN | SCHMITT_TRIGGER_DISABLE | SLEW_RATE_DISABLE)  // PIN_1J20 SENSOR-MCLK1
			(PIN140 | FUNCTION_MODE1 | DRIVING_SELECTOR_2 | PULL_DOWN | SCHMITT_TRIGGER_DISABLE | SLEW_RATE_DISABLE)  // PIN_A23 SPI-M1
#ifdef AR_FEAT_EIS
		    (PIN141 | FUNCTION_MODE5 | DRIVING_SELECTOR_2 | PULL_DOWN | SCHMITT_TRIGGER_DISABLE | SLEW_RATE_DISABLE)  // PIN_A22 SPI-M1
#else
			(PIN141 | FUNCTION_MODE1 | DRIVING_SELECTOR_2 | PULL_UP | SCHMITT_TRIGGER_DISABLE | SLEW_RATE_DISABLE)  // PIN_A22 SPI-M1
#endif
			(PIN142 | FUNCTION_MODE1 | DRIVING_SELECTOR_2 | PULL_DOWN | SCHMITT_TRIGGER_DISABLE | SLEW_RATE_DISABLE)  // PIN_B22 SPI-M1
			(PIN143 | FUNCTION_MODE1 | DRIVING_SELECTOR_2 | PULL_DOWN | SCHMITT_TRIGGER_DISABLE | SLEW_RATE_DISABLE)  // PIN_B21 SPI-M1
			(PIN145 | FUNCTION_MODE2 | DRIVING_SELECTOR_2 | PULL_DOWN | SCHMITT_TRIGGER_DISABLE | SLEW_RATE_DISABLE)  // PIN_1D18 I2SS1
			(PIN146 | FUNCTION_MODE2 | DRIVING_SELECTOR_2 | PULL_DOWN | SCHMITT_TRIGGER_DISABLE | SLEW_RATE_DISABLE)  // PIN_1F18 I2SS1
			(PIN147 | FUNCTION_MODE2 | DRIVING_SELECTOR_2 | PULL_DOWN | SCHMITT_TRIGGER_DISABLE | SLEW_RATE_DISABLE)  // PIN_1E19 I2SS1
			(PIN148 | FUNCTION_MODE2 | DRIVING_SELECTOR_2 | PULL_DOWN | SCHMITT_TRIGGER_DISABLE | SLEW_RATE_DISABLE)  // PIN_1D20 I2SS1
			(PIN149 | FUNCTION_MODE2 | DRIVING_SELECTOR_2 | PULL_DOWN | SCHMITT_TRIGGER_DISABLE | SLEW_RATE_DISABLE)  // PIN_T37 UART1
			(PIN150 | FUNCTION_MODE2 | DRIVING_SELECTOR_2 | PULL_DOWN | SCHMITT_TRIGGER_DISABLE | SLEW_RATE_DISABLE)  // PIN_U37 UART1
			(PIN151 | FUNCTION_MODE2 | DRIVING_SELECTOR_2 | PULL_UP | SCHMITT_TRIGGER_DISABLE | SLEW_RATE_DISABLE)  // PIN_U36 I2C0
			(PIN152 | FUNCTION_MODE2 | DRIVING_SELECTOR_2 | PULL_UP | SCHMITT_TRIGGER_DISABLE | SLEW_RATE_DISABLE)  // PIN_V36 I2C0
			(PIN153 | FUNCTION_MODE2 | DRIVING_SELECTOR_2 | PULL_UP | SCHMITT_TRIGGER_DISABLE | SLEW_RATE_DISABLE)  // PIN_W36 I2C1
			(PIN154 | FUNCTION_MODE2 | DRIVING_SELECTOR_2 | PULL_UP | SCHMITT_TRIGGER_DISABLE | SLEW_RATE_DISABLE)  // PIN_1D19 I2C1
			(PIN155 | FUNCTION_MODE2 | DRIVING_SELECTOR_2 | PULL_UP | SCHMITT_TRIGGER_DISABLE | SLEW_RATE_DISABLE)  // PIN_W37 I2C2
			(PIN156 | FUNCTION_MODE2 | DRIVING_SELECTOR_2 | PULL_UP | SCHMITT_TRIGGER_DISABLE | SLEW_RATE_DISABLE)  // PIN_Y37 I2C2
			(PIN157 | FUNCTION_MODE2 | DRIVING_SELECTOR_2 | PULL_UP | SCHMITT_TRIGGER_DISABLE | SLEW_RATE_DISABLE)  // PIN_Y36 I2C3
			(PIN158 | FUNCTION_MODE2 | DRIVING_SELECTOR_2 | PULL_UP | SCHMITT_TRIGGER_DISABLE | SLEW_RATE_DISABLE)  // PIN_AA36 I2C3
			(PIN159 | FUNCTION_MODE0 | DRIVING_SELECTOR_2 | PULL_DOWN | SCHMITT_TRIGGER_DISABLE | SLEW_RATE_DISABLE)  // PIN_1L20 UART0
			(PIN160 | FUNCTION_MODE0 | DRIVING_SELECTOR_2 | PULL_DOWN | SCHMITT_TRIGGER_DISABLE | SLEW_RATE_DISABLE)  // PIN_1M20 UART0
			(PIN165 | FUNCTION_MODE2 | DRIVING_SELECTOR_2 | PULL_DOWN | SCHMITT_TRIGGER_DISABLE | SLEW_RATE_DISABLE)  // PIN_1M18 UART4
			(PIN166 | FUNCTION_MODE2 | DRIVING_SELECTOR_2 | PULL_DOWN | SCHMITT_TRIGGER_DISABLE | SLEW_RATE_DISABLE)  // PIN_AB37 UART4
			(PIN169 | FUNCTION_MODE2 | DRIVING_SELECTOR_2 | PULL_DOWN | SCHMITT_TRIGGER_DISABLE | SLEW_RATE_DISABLE)  // PIN_AD36 CAN1
			(PIN170 | FUNCTION_MODE2 | DRIVING_SELECTOR_2 | PULL_DOWN | SCHMITT_TRIGGER_DISABLE | SLEW_RATE_DISABLE)  // PIN_AE36 CAN1
			(PIN171 | FUNCTION_MODE2 | DRIVING_SELECTOR_2 | PULL_DOWN | SCHMITT_TRIGGER_DISABLE | SLEW_RATE_DISABLE)  // PIN_1E20 CAN2
			(PIN172 | FUNCTION_MODE2 | DRIVING_SELECTOR_2 | PULL_DOWN | SCHMITT_TRIGGER_DISABLE | SLEW_RATE_DISABLE)  // PIN_K36 CAN2
			(PIN173 | FUNCTION_MODE2 | DRIVING_SELECTOR_2 | PULL_DOWN | SCHMITT_TRIGGER_DISABLE | SLEW_RATE_DISABLE)  // PIN_J36 CAN3
			(PIN174 | FUNCTION_MODE2 | DRIVING_SELECTOR_2 | PULL_DOWN | SCHMITT_TRIGGER_DISABLE | SLEW_RATE_DISABLE)  // PIN_K37 CAN3
			(PIN175 | FUNCTION_MODE2 | DRIVING_SELECTOR_2 | PULL_DOWN | SCHMITT_TRIGGER_DISABLE | SLEW_RATE_DISABLE)  // PIN_1P2 GMAC0
			(PIN176 | FUNCTION_MODE2 | DRIVING_SELECTOR_2 | PULL_DOWN | SCHMITT_TRIGGER_DISABLE | SLEW_RATE_DISABLE)  // PIN_1R1 GMAC0
			(PIN177 | FUNCTION_MODE2 | DRIVING_SELECTOR_2 | PULL_DOWN | SCHMITT_TRIGGER_DISABLE | SLEW_RATE_DISABLE)  // PIN_1P1 GMAC0
			(PIN178 | FUNCTION_MODE2 | DRIVING_SELECTOR_2 | PULL_DOWN | SCHMITT_TRIGGER_DISABLE | SLEW_RATE_DISABLE)  // PIN_AF2 GMAC0
			(PIN179 | FUNCTION_MODE2 | DRIVING_SELECTOR_2 | PULL_DOWN | SCHMITT_TRIGGER_DISABLE | SLEW_RATE_DISABLE)  // PIN_AE2 GMAC0
			(PIN180 | FUNCTION_MODE2 | DRIVING_SELECTOR_2 | PULL_DOWN | SCHMITT_TRIGGER_DISABLE | SLEW_RATE_DISABLE)  // PIN_AE1 GMAC0
			(PIN181 | FUNCTION_MODE2 | DRIVING_SELECTOR_2 | PULL_DOWN | SCHMITT_TRIGGER_DISABLE | SLEW_RATE_DISABLE)  // PIN_1M3 GMAC0
			(PIN182 | FUNCTION_MODE2 | DRIVING_SELECTOR_2 | PULL_DOWN | SCHMITT_TRIGGER_DISABLE | SLEW_RATE_DISABLE)  // PIN_1M2 GMAC0
			(PIN183 | FUNCTION_MODE2 | DRIVING_SELECTOR_2 | PULL_DOWN | SCHMITT_TRIGGER_DISABLE | SLEW_RATE_DISABLE)  // PIN_AD2 GMAC0
			(PIN184 | FUNCTION_MODE2 | DRIVING_SELECTOR_2 | PULL_DOWN | SCHMITT_TRIGGER_DISABLE | SLEW_RATE_DISABLE)  // PIN_AD1 GMAC0
			(PIN185 | FUNCTION_MODE2 | DRIVING_SELECTOR_2 | PULL_DOWN | SCHMITT_TRIGGER_DISABLE | SLEW_RATE_DISABLE)  // PIN_1M1 GMAC0
			(PIN186 | FUNCTION_MODE2 | DRIVING_SELECTOR_2 | PULL_DOWN | SCHMITT_TRIGGER_DISABLE | SLEW_RATE_DISABLE)  // PIN_AC2 GMAC0
			(PIN187 | FUNCTION_MODE2 | DRIVING_SELECTOR_2 | PULL_DOWN | SCHMITT_TRIGGER_DISABLE | SLEW_RATE_DISABLE)  // PIN_AB2 GMAC0
			(PIN188 | FUNCTION_MODE2 | DRIVING_SELECTOR_2 | PULL_DOWN | SCHMITT_TRIGGER_DISABLE | SLEW_RATE_DISABLE)  // PIN_AB1 GMAC0
			(PIN189 | FUNCTION_MODE2 | DRIVING_SELECTOR_2 | PULL_DOWN | SCHMITT_TRIGGER_DISABLE | SLEW_RATE_DISABLE)  // PIN_AA2 GMAC0
			(PIN190 | FUNCTION_MODE2 | DRIVING_SELECTOR_2 | PULL_DOWN | SCHMITT_TRIGGER_DISABLE | SLEW_RATE_DISABLE)  // PIN_Y2 GMAC0
			(PIN191 | FUNCTION_MODE2 | DRIVING_SELECTOR_2 | PULL_DOWN | SCHMITT_TRIGGER_DISABLE | SLEW_RATE_DISABLE)  // PIN_AA1 GMAC0
			// GPIO
			(PIN36 | FUNCTION_MODE2 | DRIVING_SELECTOR_2 | PULL_DOWN | SCHMITT_TRIGGER_DISABLE | SLEW_RATE_DISABLE)  // PIN_1A11 GPIO_B1_6 AMP_EN
			(PIN81 | FUNCTION_MODE0 | DRIVING_SELECTOR_2 | PULL_DOWN | SCHMITT_TRIGGER_DISABLE | SLEW_RATE_DISABLE)  // PIN_1W7
			(PIN127 | FUNCTION_MODE4 | DRIVING_SELECTOR_2 | PULL_DOWN | SCHMITT_TRIGGER_DISABLE | SLEW_RATE_DISABLE)  // PIN_L36 GPIO_D1_4
			(PIN128 | FUNCTION_MODE4 | DRIVING_SELECTOR_2 | PULL_DOWN | SCHMITT_TRIGGER_DISABLE | SLEW_RATE_DISABLE)  // PIN_L37 GPIO_D1_5
			(PIN129 | FUNCTION_MODE4 | DRIVING_SELECTOR_2 | PULL_DOWN | SCHMITT_TRIGGER_DISABLE | SLEW_RATE_DISABLE)  // PIN_M36 GPIO_D1_6
			(PIN144 | FUNCTION_MODE0 | DRIVING_SELECTOR_2 | PULL_DOWN | SCHMITT_TRIGGER_DISABLE | SLEW_RATE_DISABLE)  // PIN_T36
			(PIN88 | FUNCTION_MODE0 | DRIVING_SELECTOR_2 | PULL_UP | SCHMITT_TRIGGER_DISABLE | SLEW_RATE_DISABLE)  // PIN_F36
			(PIN101 | FUNCTION_MODE0 | DRIVING_SELECTOR_2 | PULL_DOWN | SCHMITT_TRIGGER_DISABLE | SLEW_RATE_DISABLE)  // PIN_1C20
			(PIN109 | FUNCTION_MODE0 | DRIVING_SELECTOR_2 | PULL_DOWN | SCHMITT_TRIGGER_DISABLE | SLEW_RATE_DISABLE)  // PIN_1C19
			(PIN110 | FUNCTION_MODE0 | DRIVING_SELECTOR_2 | PULL_DOWN | SCHMITT_TRIGGER_DISABLE | SLEW_RATE_DISABLE)  // PIN_H37
			(PIN26 | FUNCTION_MODE3 | DRIVING_SELECTOR_2 | PULL_DOWN | SCHMITT_TRIGGER_DISABLE | SLEW_RATE_DISABLE)  // PIN_1D11
			(PIN28 | FUNCTION_MODE2 | DRIVING_SELECTOR_2 | PULL_DOWN | SCHMITT_TRIGGER_DISABLE | SLEW_RATE_DISABLE)  // PIN_1B15
			(PIN31 | FUNCTION_MODE2 | DRIVING_SELECTOR_2 | PULL_DOWN | SCHMITT_TRIGGER_DISABLE | SLEW_RATE_DISABLE)  // PIN_1A14
			(PIN32 | FUNCTION_MODE2 | DRIVING_SELECTOR_2 | PULL_DOWN | SCHMITT_TRIGGER_DISABLE | SLEW_RATE_DISABLE)  // PIN_1A15
			(PIN30 | FUNCTION_MODE2 | DRIVING_SELECTOR_2 | PULL_DOWN | SCHMITT_TRIGGER_DISABLE | SLEW_RATE_DISABLE)  // PIN_1C12
			(PIN49 | FUNCTION_MODE2 | DRIVING_SELECTOR_2 | PULL_DOWN | SCHMITT_TRIGGER_DISABLE | SLEW_RATE_DISABLE)  // PIN_A26
			(PIN48 | FUNCTION_MODE2 | DRIVING_SELECTOR_2 | PULL_DOWN | SCHMITT_TRIGGER_DISABLE | SLEW_RATE_DISABLE)  // PIN_A25
			(PIN47 | FUNCTION_MODE2 | DRIVING_SELECTOR_2 | PULL_DOWN | SCHMITT_TRIGGER_DISABLE | SLEW_RATE_DISABLE)  // PIN_A29
			(PIN46 | FUNCTION_MODE2 | DRIVING_SELECTOR_2 | PULL_DOWN | SCHMITT_TRIGGER_DISABLE | SLEW_RATE_DISABLE)  // PIN_A28
			(PIN40 | FUNCTION_MODE2 | DRIVING_SELECTOR_2 | PULL_DOWN | SCHMITT_TRIGGER_DISABLE | SLEW_RATE_DISABLE)  // PIN_B28
			(PIN41 | FUNCTION_MODE2 | DRIVING_SELECTOR_2 | PULL_DOWN | SCHMITT_TRIGGER_DISABLE | SLEW_RATE_DISABLE)  // PIN_B29
			(PIN39 | FUNCTION_MODE2 | DRIVING_SELECTOR_2 | PULL_DOWN | SCHMITT_TRIGGER_DISABLE | SLEW_RATE_DISABLE)  // PIN_B30
			(PIN38 | FUNCTION_MODE2 | DRIVING_SELECTOR_2 | PULL_UP | SCHMITT_TRIGGER_DISABLE | SLEW_RATE_DISABLE)  // PIN_A31
			(PIN124 | FUNCTION_MODE0 | DRIVING_SELECTOR_2 | PULL_DOWN | SCHMITT_TRIGGER_DISABLE | SLEW_RATE_DISABLE)  // PIN_1F17
                        // GPIO
			(PIN34 | FUNCTION_MODE2 | DRIVING_SELECTOR_2 | PULL_UP | SCHMITT_TRIGGER_DISABLE | SLEW_RATE_DISABLE)   // PIN_1C11 WL_REG_ON
			(PIN35 | FUNCTION_MODE2 | DRIVING_SELECTOR_2 | PULL_UP | SCHMITT_TRIGGER_DISABLE | SLEW_RATE_DISABLE)   // PIN_1A12 WL_HOST_WAKE
#ifdef AR_FEAT_EIS
			(PIN102 | FUNCTION_MODE0 | DRIVING_SELECTOR_2 | PULL_UP | SCHMITT_TRIGGER_DISABLE | SLEW_RATE_DISABLE)  // PIN_1V20 SD2
			(PIN103 | FUNCTION_MODE0 | DRIVING_SELECTOR_2 | PULL_UP | SCHMITT_TRIGGER_DISABLE | SLEW_RATE_DISABLE)  // PIN_1W20 SD2
			(PIN104 | FUNCTION_MODE0 | DRIVING_SELECTOR_2 | PULL_UP | SCHMITT_TRIGGER_DISABLE | SLEW_RATE_DISABLE)  // PIN_1U20 SD2
			(PIN105 | FUNCTION_MODE0 | DRIVING_SELECTOR_2 | PULL_UP | SCHMITT_TRIGGER_DISABLE | SLEW_RATE_DISABLE)  // PIN_1U19 SD2
			(PIN106 | FUNCTION_MODE0 | DRIVING_SELECTOR_2 | PULL_UP | SCHMITT_TRIGGER_DISABLE | SLEW_RATE_DISABLE)  // PIN_1V19 SD2
			(PIN107 | FUNCTION_MODE0 | DRIVING_SELECTOR_2 | PULL_UP | SCHMITT_TRIGGER_DISABLE | SLEW_RATE_DISABLE)  // PIN_1U18 SD2
#else
			(PIN102 | FUNCTION_MODE2 | DRIVING_SELECTOR_2 | PULL_UP | SCHMITT_TRIGGER_DISABLE | SLEW_RATE_DISABLE)  // PIN_1V20 SD2
			(PIN103 | FUNCTION_MODE2 | DRIVING_SELECTOR_2 | PULL_UP | SCHMITT_TRIGGER_DISABLE | SLEW_RATE_DISABLE)  // PIN_1W20 SD2
			(PIN104 | FUNCTION_MODE2 | DRIVING_SELECTOR_2 | PULL_UP | SCHMITT_TRIGGER_DISABLE | SLEW_RATE_DISABLE)  // PIN_1U20 SD2
			(PIN105 | FUNCTION_MODE2 | DRIVING_SELECTOR_2 | PULL_UP | SCHMITT_TRIGGER_DISABLE | SLEW_RATE_DISABLE)  // PIN_1U19 SD2
			(PIN106 | FUNCTION_MODE2 | DRIVING_SELECTOR_2 | PULL_UP | SCHMITT_TRIGGER_DISABLE | SLEW_RATE_DISABLE)  // PIN_1V19 SD2
			(PIN107 | FUNCTION_MODE2 | DRIVING_SELECTOR_2 | PULL_UP | SCHMITT_TRIGGER_DISABLE | SLEW_RATE_DISABLE)  // PIN_1U18 SD2
#endif
			(PIN85 | FUNCTION_MODE2 | DRIVING_SELECTOR_2 | PULL_UP | SCHMITT_TRIGGER_DISABLE | SLEW_RATE_DISABLE)  // PIN_1R20 SD0
			(PIN86 | FUNCTION_MODE2 | DRIVING_SELECTOR_2 | PULL_UP | SCHMITT_TRIGGER_DISABLE | SLEW_RATE_DISABLE)  // PIN_1P20 SD0
			(PIN87 | FUNCTION_MODE2 | DRIVING_SELECTOR_2 | PULL_UP | SCHMITT_TRIGGER_DISABLE | SLEW_RATE_DISABLE)  // PIN_E36 SD0
#ifdef AR_FEAT_EIS
			(PIN89 | FUNCTION_MODE0 | DRIVING_SELECTOR_2 | PULL_UP | SCHMITT_TRIGGER_DISABLE | SLEW_RATE_DISABLE)  // PIN_1P19 SD0
			(PIN90 | FUNCTION_MODE0 | DRIVING_SELECTOR_2 | PULL_UP | SCHMITT_TRIGGER_DISABLE | SLEW_RATE_DISABLE)  // PIN_1R19 SD0
			(PIN91 | FUNCTION_MODE0 | DRIVING_SELECTOR_2 | PULL_UP | SCHMITT_TRIGGER_DISABLE | SLEW_RATE_DISABLE)  // PIN_1R18 SD0
#else
			(PIN89 | FUNCTION_MODE2 | DRIVING_SELECTOR_2 | PULL_UP | SCHMITT_TRIGGER_DISABLE | SLEW_RATE_DISABLE)  // PIN_1P19 SD0
			(PIN90 | FUNCTION_MODE2 | DRIVING_SELECTOR_2 | PULL_UP | SCHMITT_TRIGGER_DISABLE | SLEW_RATE_DISABLE)  // PIN_1R19 SD0
			(PIN91 | FUNCTION_MODE2 | DRIVING_SELECTOR_2 | PULL_UP | SCHMITT_TRIGGER_DISABLE | SLEW_RATE_DISABLE)  // PIN_1R18 SD0
#endif
			(PIN92 | FUNCTION_MODE2 | DRIVING_SELECTOR_2 | PULL_UP | SCHMITT_TRIGGER_DISABLE | SLEW_RATE_DISABLE)  // PIN_1P18 SD0
#ifdef AR_FEAT_EIS
			(PIN93 | FUNCTION_MODE0 | DRIVING_SELECTOR_2 | PULL_DOWN | SCHMITT_TRIGGER_DISABLE | SLEW_RATE_DISABLE)  // PIN_AG36 SD1
			(PIN94 | FUNCTION_MODE0 | DRIVING_SELECTOR_2 | PULL_UP | SCHMITT_TRIGGER_DISABLE | SLEW_RATE_DISABLE)  // PIN_AF36 SD1
#else
			(PIN93 | FUNCTION_MODE2 | DRIVING_SELECTOR_2 | PULL_UP | SCHMITT_TRIGGER_DISABLE | SLEW_RATE_DISABLE)  // PIN_AG36 SD1
			(PIN94 | FUNCTION_MODE2 | DRIVING_SELECTOR_2 | PULL_UP | SCHMITT_TRIGGER_DISABLE | SLEW_RATE_DISABLE)  // PIN_AF36 SD1
#endif
			(PIN95 | FUNCTION_MODE2 | DRIVING_SELECTOR_2 | PULL_UP | SCHMITT_TRIGGER_DISABLE | SLEW_RATE_DISABLE)  // PIN_AH36 SD1
			(PIN96 | FUNCTION_MODE2 | DRIVING_SELECTOR_2 | PULL_UP | SCHMITT_TRIGGER_DISABLE | SLEW_RATE_DISABLE)  // PIN_AH37 SD1
			(PIN97 | FUNCTION_MODE2 | DRIVING_SELECTOR_2 | PULL_UP | SCHMITT_TRIGGER_DISABLE | SLEW_RATE_DISABLE)  // PIN_AJ36 SD1
			(PIN98 | FUNCTION_MODE2 | DRIVING_SELECTOR_2 | PULL_UP | SCHMITT_TRIGGER_DISABLE | SLEW_RATE_DISABLE)  // PIN_AJ37 SD1
		>;
		pb-msc-cfgs = <
#ifdef AR_FEAT_EIS
			(PB_MSC_BIT0  | PB_MSC_REG_PIN_V18)  // PB085_086, PB089_092
#else
			(PB_MSC_BIT0  | PB_MSC_REG_PIN_V33)  // PB085_086, PB089_092
#endif
			(PB_MSC_BIT1  | PB_MSC_REG_PIN_V18)  // PB093_098
#ifdef AR_FEAT_EIS
			(PB_MSC_BIT2  | PB_MSC_REG_PIN_V18)  // PB102_107
#else
			(PB_MSC_BIT2  | PB_MSC_REG_PIN_V33)  // PB102_107
#endif
			(PB_MSC_BIT3  | PB_MSC_REG_PIN_V33)  // PB111_116
			(PB_MSC_BIT4  | PB_MSC_REG_PIN_V33)  // PB117_121
			(PB_MSC_BIT5  | PB_MSC_REG_PIN_V18)  // PB002_025
			(PB_MSC_BIT6  | PB_MSC_REG_PIN_V18)  // PB026_049
			(PB_MSC_BIT7  | PB_MSC_REG_PIN_V18)  // PB050_081
			(PB_MSC_BIT8  | PB_MSC_REG_PIN_V18)  // PB082_083, PB140_143
			(PB_MSC_BIT9  | PB_MSC_REG_PIN_V18)  // PB084, PB087_088, PB099_101, PB108_110, PB122_139, PB144_174, PB192
			(PB_MSC_BIT10 | PB_MSC_REG_PIN_V18)  // PB175_191
		>;
	};
};
