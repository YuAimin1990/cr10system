#include <dt-bindings/pinctrl/pinctrl-ar9301.h>

&soc {
	pinctrl {
		u-boot,dm-pre-reloc;
		compatible = "artosyn,ar9301-pinctrl";
		reg = <0x01073000 0x00000108	// pb_sw_reg_base
		       0x01073130 0x00000060>;	// pad_func_sel_base
		pinctrl-cfgs = <
			//GPIO
			(PIN4 | FUNCTION_MODE2 | DRIVING_SELECTOR_2 | PULL_UP | SCHMITT_TRIGGER_DISABLE | SLEW_RATE_DISABLE)  			//GPIO_A0_2  D36
			
			//DVP
			(PIN6 | FUNCTION_MODE0 | DRIVING_SELECTOR_2 | PULL_DOWN | SCHMITT_TRIGGER_DISABLE | SLEW_RATE_DISABLE)			//PDATA0_0_A  B37
			(PIN7 | FUNCTION_MODE0 | DRIVING_SELECTOR_2 | PULL_DOWN | SCHMITT_TRIGGER_DISABLE | SLEW_RATE_DISABLE)
			(PIN8 | FUNCTION_MODE0 | DRIVING_SELECTOR_2 | PULL_DOWN | SCHMITT_TRIGGER_DISABLE | SLEW_RATE_DISABLE)
			(PIN9 | FUNCTION_MODE0 | DRIVING_SELECTOR_2 | PULL_DOWN | SCHMITT_TRIGGER_DISABLE | SLEW_RATE_DISABLE)
			(PIN10 | FUNCTION_MODE0 | DRIVING_SELECTOR_2 | PULL_DOWN | SCHMITT_TRIGGER_DISABLE | SLEW_RATE_DISABLE)
			(PIN11 | FUNCTION_MODE0 | DRIVING_SELECTOR_2 | PULL_DOWN | SCHMITT_TRIGGER_DISABLE | SLEW_RATE_DISABLE)
			(PIN12 | FUNCTION_MODE0 | DRIVING_SELECTOR_2 | PULL_DOWN | SCHMITT_TRIGGER_DISABLE | SLEW_RATE_DISABLE)
			(PIN13 | FUNCTION_MODE0 | DRIVING_SELECTOR_2 | PULL_DOWN | SCHMITT_TRIGGER_DISABLE | SLEW_RATE_DISABLE)
			(PIN14 | FUNCTION_MODE0 | DRIVING_SELECTOR_2 | PULL_DOWN | SCHMITT_TRIGGER_DISABLE | SLEW_RATE_DISABLE)
			(PIN15 | FUNCTION_MODE0 | DRIVING_SELECTOR_2 | PULL_DOWN | SCHMITT_TRIGGER_DISABLE | SLEW_RATE_DISABLE)
			(PIN16 | FUNCTION_MODE0 | DRIVING_SELECTOR_2 | PULL_DOWN | SCHMITT_TRIGGER_DISABLE | SLEW_RATE_DISABLE)
			(PIN17 | FUNCTION_MODE0 | DRIVING_SELECTOR_2 | PULL_DOWN | SCHMITT_TRIGGER_DISABLE | SLEW_RATE_DISABLE)			//PHSYNC0_A  1B18
			//GPIO
			(PIN18 | FUNCTION_MODE2 | DRIVING_SELECTOR_2 | PULL_DOWN | SCHMITT_TRIGGER_DISABLE | SLEW_RATE_DISABLE)			//GPIO_A1_3  1B17
			(PIN19 | FUNCTION_MODE2 | DRIVING_SELECTOR_2 | PULL_DOWN | SCHMITT_TRIGGER_DISABLE | SLEW_RATE_DISABLE)			//GPIO_A1_4  1B19
			(PIN20 | FUNCTION_MODE2 | DRIVING_SELECTOR_2 | PULL_DOWN | SCHMITT_TRIGGER_DISABLE | SLEW_RATE_DISABLE)			//GPIO_A1_5  1A18
			(PIN21 | FUNCTION_MODE2 | DRIVING_SELECTOR_2 | PULL_DOWN | SCHMITT_TRIGGER_DISABLE | SLEW_RATE_DISABLE)			//GPIO_A1_6  1A17
			
			//UART2
			(PIN22 | FUNCTION_MODE5 | DRIVING_SELECTOR_2 | PULL_DOWN | SCHMITT_TRIGGER_DISABLE | SLEW_RATE_DISABLE)			//UART_SIN2  1D14
			(PIN23 | FUNCTION_MODE5 | DRIVING_SELECTOR_2 | PULL_DOWN | SCHMITT_TRIGGER_DISABLE | SLEW_RATE_DISABLE)			//UART_SOUT2  1D13
			
			//no using
			(PIN24 | FUNCTION_MODE2 | DRIVING_SELECTOR_2 | PULL_DOWN | SCHMITT_TRIGGER_DISABLE | SLEW_RATE_DISABLE)			//PDATA1_6_A   1C14
			(PIN25 | FUNCTION_MODE2 | DRIVING_SELECTOR_2 | PULL_DOWN | SCHMITT_TRIGGER_DISABLE | SLEW_RATE_DISABLE)			//PDATA1_7_A   1D12
			
			//I2C0
			(PIN26 | FUNCTION_MODE6 | DRIVING_SELECTOR_2 | PULL_UP | SCHMITT_TRIGGER_DISABLE | SLEW_RATE_DISABLE)			//I2C_SDA0  1D11
			(PIN27 | FUNCTION_MODE6 | DRIVING_SELECTOR_2 | PULL_UP | SCHMITT_TRIGGER_DISABLE | SLEW_RATE_DISABLE)			//I2C_SCLK0  1B14
			//I2C1
			(PIN28 | FUNCTION_MODE6 | DRIVING_SELECTOR_2 | PULL_UP | SCHMITT_TRIGGER_DISABLE | SLEW_RATE_DISABLE)			//I2C_SDA1 1B15
			(PIN29 | FUNCTION_MODE6 | DRIVING_SELECTOR_2 | PULL_UP | SCHMITT_TRIGGER_DISABLE | SLEW_RATE_DISABLE)			//I2C_SCLK1 1C15
			
			//CAM
			(PIN30 | FUNCTION_MODE1 | DRIVING_SELECTOR_0 | PULL_DOWN | SCHMITT_TRIGGER_DISABLE | SLEW_RATE_DISABLE)			//Sensor_Mclk0 1C12
			(PIN31 | FUNCTION_MODE1 | DRIVING_SELECTOR_0 | PULL_DOWN | SCHMITT_TRIGGER_DISABLE | SLEW_RATE_DISABLE)			//Sensor_Mclk1 1A14
			(PIN32 | FUNCTION_MODE1 | DRIVING_SELECTOR_0 | PULL_DOWN | SCHMITT_TRIGGER_DISABLE | SLEW_RATE_DISABLE)			//Sensor_Mclk2 1A15
			//GPIO
			(PIN38 | FUNCTION_MODE2 | DRIVING_SELECTOR_2 | PULL_DOWN | SCHMITT_TRIGGER_DISABLE | SLEW_RATE_DISABLE)			//GPIO_C1_0  A31
			(PIN39 | FUNCTION_MODE2 | DRIVING_SELECTOR_2 | PULL_DOWN | SCHMITT_TRIGGER_DISABLE | SLEW_RATE_DISABLE)			//GPIO_C1_1  B30
			
			//UART1
			(PIN40 | FUNCTION_MODE3 | DRIVING_SELECTOR_2 | PULL_DOWN | SCHMITT_TRIGGER_DISABLE | SLEW_RATE_DISABLE)			//UART_SIN1  B28 
			(PIN41 | FUNCTION_MODE3 | DRIVING_SELECTOR_2 | PULL_DOWN | SCHMITT_TRIGGER_DISABLE | SLEW_RATE_DISABLE)			//UART_SOUT1  B29 
			
			//GPIO
			(PIN42 | FUNCTION_MODE2 | DRIVING_SELECTOR_2 | PULL_UP | SCHMITT_TRIGGER_DISABLE | SLEW_RATE_DISABLE)			//GPIO_C1_4  B26
			(PIN43 | FUNCTION_MODE2 | DRIVING_SELECTOR_2 | PULL_DOWN | SCHMITT_TRIGGER_DISABLE | SLEW_RATE_DISABLE)			//GPIO_C1_5  B27
			(PIN44 | FUNCTION_MODE2 | DRIVING_SELECTOR_2 | PULL_DOWN | SCHMITT_TRIGGER_DISABLE | SLEW_RATE_DISABLE)			//GPIO_C1_6  B25
			
			//I2C2
			(PIN45 | FUNCTION_MODE6 | DRIVING_SELECTOR_2 | PULL_UP | SCHMITT_TRIGGER_DISABLE | SLEW_RATE_DISABLE)			//I2C_SDA2	B24
			(PIN46 | FUNCTION_MODE6 | DRIVING_SELECTOR_2 | PULL_UP | SCHMITT_TRIGGER_DISABLE | SLEW_RATE_DISABLE)			//I2C_SCLK2	A28
			
			(PIN47 | FUNCTION_MODE0 | DRIVING_SELECTOR_2 | PULL_DOWN | SCHMITT_TRIGGER_DISABLE | SLEW_RATE_DISABLE)			//PDATA0_5_B A29
			(PIN48 | FUNCTION_MODE0 | DRIVING_SELECTOR_2 | PULL_DOWN | SCHMITT_TRIGGER_DISABLE | SLEW_RATE_DISABLE)			//PDATA0_6_B A25
			(PIN49 | FUNCTION_MODE0 | DRIVING_SELECTOR_2 | PULL_DOWN | SCHMITT_TRIGGER_DISABLE | SLEW_RATE_DISABLE)			//PDATA0_7_B A26
			
			//I2C4
			(PIN50 | FUNCTION_MODE1 | DRIVING_SELECTOR_2 | PULL_UP | SCHMITT_TRIGGER_DISABLE | SLEW_RATE_DISABLE)			//I2C_SCLK4  AL37
			(PIN51 | FUNCTION_MODE1 | DRIVING_SELECTOR_2 | PULL_UP | SCHMITT_TRIGGER_DISABLE | SLEW_RATE_DISABLE)			//I2C_SDA4   AK36
			
			(PIN52 | FUNCTION_MODE2 | DRIVING_SELECTOR_2 | PULL_DOWN | SCHMITT_TRIGGER_DISABLE | SLEW_RATE_DISABLE)			//PDATA0_2_C  AL36
			(PIN53 | FUNCTION_MODE2 | DRIVING_SELECTOR_0 | PULL_DOWN | SCHMITT_TRIGGER_DISABLE | SLEW_RATE_DISABLE)			//PDATA0_3_C  AM36
			(PIN54 | FUNCTION_MODE2 | DRIVING_SELECTOR_0 | PULL_DOWN | SCHMITT_TRIGGER_DISABLE | SLEW_RATE_DISABLE)			//PDATA0_4_C  AN36
			(PIN55 | FUNCTION_MODE2 | DRIVING_SELECTOR_0 | PULL_DOWN | SCHMITT_TRIGGER_DISABLE | SLEW_RATE_DISABLE)			//PDATA0_5_C  AP36
			(PIN56 | FUNCTION_MODE2 | DRIVING_SELECTOR_0 | PULL_DOWN | SCHMITT_TRIGGER_DISABLE | SLEW_RATE_DISABLE)			//PDATA0_6_C  AM37
			(PIN57 | FUNCTION_MODE2 | DRIVING_SELECTOR_0 | PULL_DOWN | SCHMITT_TRIGGER_DISABLE | SLEW_RATE_DISABLE)			//PDATA0_7_C  AR37
			(PIN58 | FUNCTION_MODE2 | DRIVING_SELECTOR_0 | PULL_DOWN | SCHMITT_TRIGGER_DISABLE | SLEW_RATE_DISABLE)			//PCLK0_C  AP37
			(PIN59 | FUNCTION_MODE2 | DRIVING_SELECTOR_2 | PULL_DOWN | SCHMITT_TRIGGER_DISABLE | SLEW_RATE_DISABLE)			//PDE0_C  1W18
			(PIN60 | FUNCTION_MODE2 | DRIVING_SELECTOR_2 | PULL_DOWN | SCHMITT_TRIGGER_DISABLE | SLEW_RATE_DISABLE)			//PHSYNC0_C  AR36
			(PIN61 | FUNCTION_MODE2 | DRIVING_SELECTOR_2 | PULL_DOWN | SCHMITT_TRIGGER_DISABLE | SLEW_RATE_DISABLE)			//PHSYNC0_C  1Y17
			(PIN62 | FUNCTION_MODE6 | DRIVING_SELECTOR_2 | PULL_DOWN | SCHMITT_TRIGGER_DISABLE | SLEW_RATE_DISABLE)			//CEVA_UART_TX  1W17
			
			(PIN63 | FUNCTION_MODE0 | DRIVING_SELECTOR_2 | PULL_DOWN | SCHMITT_TRIGGER_DISABLE | SLEW_RATE_DISABLE)			//JTAG_TMS  1Y13
			(PIN64 | FUNCTION_MODE0 | DRIVING_SELECTOR_2 | PULL_DOWN | SCHMITT_TRIGGER_DISABLE | SLEW_RATE_DISABLE)			//JTAG_TCK  1V16
			
			(PIN66 | FUNCTION_MODE2 | DRIVING_SELECTOR_2 | PULL_DOWN | SCHMITT_TRIGGER_DISABLE | SLEW_RATE_DISABLE)			//PDATA1_0_C  1W14
			(PIN67 | FUNCTION_MODE2 | DRIVING_SELECTOR_2 | PULL_DOWN | SCHMITT_TRIGGER_DISABLE | SLEW_RATE_DISABLE)			//PDATA1_1_C  1W13
			(PIN68 | FUNCTION_MODE2 | DRIVING_SELECTOR_0 | PULL_DOWN | SCHMITT_TRIGGER_DISABLE | SLEW_RATE_DISABLE)			//PDATA1_2_C  1V14
			(PIN69 | FUNCTION_MODE2 | DRIVING_SELECTOR_0 | PULL_DOWN | SCHMITT_TRIGGER_DISABLE | SLEW_RATE_DISABLE)			//PDATA1_3_C  1Y11
			(PIN70 | FUNCTION_MODE2 | DRIVING_SELECTOR_0 | PULL_DOWN | SCHMITT_TRIGGER_DISABLE | SLEW_RATE_DISABLE)			//PDATA1_4_C  1Y10
			(PIN71 | FUNCTION_MODE2 | DRIVING_SELECTOR_0 | PULL_DOWN | SCHMITT_TRIGGER_DISABLE | SLEW_RATE_DISABLE)			//PDATA1_5_C  1W11
			(PIN72 | FUNCTION_MODE2 | DRIVING_SELECTOR_0 | PULL_DOWN | SCHMITT_TRIGGER_DISABLE | SLEW_RATE_DISABLE)			//PDATA1_6_C  1V13
			(PIN73 | FUNCTION_MODE2 | DRIVING_SELECTOR_0 | PULL_DOWN | SCHMITT_TRIGGER_DISABLE | SLEW_RATE_DISABLE)			//PDATA1_7_C  1V11
			
			//GPIO
			(PIN74 | FUNCTION_MODE0 | DRIVING_SELECTOR_2 | PULL_DOWN | SCHMITT_TRIGGER_DISABLE | SLEW_RATE_DISABLE)			//GPIO_B2_6  1V10
			(PIN75 | FUNCTION_MODE0 | DRIVING_SELECTOR_2 | PULL_DOWN | SCHMITT_TRIGGER_DISABLE | SLEW_RATE_DISABLE)			//GPIO_B2_7  1W10
			(PIN76 | FUNCTION_MODE0 | DRIVING_SELECTOR_2 | PULL_DOWN | SCHMITT_TRIGGER_DISABLE | SLEW_RATE_DISABLE)			//GPIO_A1_1  1Y8
			
			//DVP
			(PIN77 | FUNCTION_MODE2 | DRIVING_SELECTOR_0 | PULL_DOWN | SCHMITT_TRIGGER_DISABLE | SLEW_RATE_DISABLE)			//DVP_EXT_OUT_3  1W8
			(PIN78 | FUNCTION_MODE2 | DRIVING_SELECTOR_0 | PULL_DOWN | SCHMITT_TRIGGER_DISABLE | SLEW_RATE_DISABLE)			//DVP_EXT_OUT_4  1V8
			(PIN79 | FUNCTION_MODE2 | DRIVING_SELECTOR_0 | PULL_DOWN | SCHMITT_TRIGGER_DISABLE | SLEW_RATE_DISABLE)			//DVP_EXT_OUT_5  1Y7
			(PIN80 | FUNCTION_MODE2 | DRIVING_SELECTOR_0 | PULL_DOWN | SCHMITT_TRIGGER_DISABLE | SLEW_RATE_DISABLE)			//DVP_EXT_OUT_6  1V7
			(PIN81 | FUNCTION_MODE2 | DRIVING_SELECTOR_0 | PULL_DOWN | SCHMITT_TRIGGER_DISABLE | SLEW_RATE_DISABLE)			//DVP_EXT_OUT_7  1W7
			
			//QSPI
			(PIN82 | FUNCTION_MODE0 | DRIVING_SELECTOR_2 | PULL_DOWN | SCHMITT_TRIGGER_DISABLE | SLEW_RATE_DISABLE)			//QSPI_DATA_2  B20
			(PIN83 | FUNCTION_MODE0 | DRIVING_SELECTOR_2 | PULL_DOWN | SCHMITT_TRIGGER_DISABLE | SLEW_RATE_DISABLE)			//QSPI_DATA_3  A20
			
			//SD0
			(PIN84 | FUNCTION_MODE2 | DRIVING_SELECTOR_2 | PULL_UP | SCHMITT_TRIGGER_DISABLE | SLEW_RATE_DISABLE)     		//SD_CPOWER0  	1B20   
			(PIN85 | FUNCTION_MODE2 | DRIVING_SELECTOR_2 | PULL_UP | SCHMITT_TRIGGER_DISABLE | SLEW_RATE_DISABLE)			//SD_CCLK_OUT0  1R20
			(PIN86 | FUNCTION_MODE2 | DRIVING_SELECTOR_2 | PULL_UP | SCHMITT_TRIGGER_DISABLE | SLEW_RATE_DISABLE)			//SD_CCMD0  	1P20
			(PIN87 | FUNCTION_MODE2 | DRIVING_SELECTOR_2 | PULL_UP | SCHMITT_TRIGGER_DISABLE | SLEW_RATE_DISABLE)			//SD_CARD_DETECT_N0  E36
			(PIN88 | FUNCTION_MODE2 | DRIVING_SELECTOR_2 | PULL_UP | SCHMITT_TRIGGER_DISABLE | SLEW_RATE_DISABLE)			//SD_CARD_WPRT0  F36
			(PIN89 | FUNCTION_MODE2 | DRIVING_SELECTOR_2 | PULL_UP | SCHMITT_TRIGGER_DISABLE | SLEW_RATE_DISABLE)			//SD_CDATA0_0  1P19
			(PIN90 | FUNCTION_MODE2 | DRIVING_SELECTOR_2 | PULL_UP | SCHMITT_TRIGGER_DISABLE | SLEW_RATE_DISABLE)			//SD_CDATA0_1  1R19
			(PIN91 | FUNCTION_MODE2 | DRIVING_SELECTOR_2 | PULL_UP | SCHMITT_TRIGGER_DISABLE | SLEW_RATE_DISABLE)			//SD_CDATA0_2  1R18
			(PIN92 | FUNCTION_MODE2 | DRIVING_SELECTOR_2 | PULL_UP | SCHMITT_TRIGGER_DISABLE | SLEW_RATE_DISABLE)			//SD_CDATA0_3  1P18
			
			//GPIO
			(PIN93 | FUNCTION_MODE0 | DRIVING_SELECTOR_2 | PULL_UP | SCHMITT_TRIGGER_DISABLE | SLEW_RATE_DISABLE)			//GPIO_A1_0  AG36
			(PIN94 | FUNCTION_MODE0 | DRIVING_SELECTOR_2 | PULL_DOWN | SCHMITT_TRIGGER_DISABLE | SLEW_RATE_DISABLE)			//GPIO_A3_0  AF36
			
			//SD1
			(PIN95 | FUNCTION_MODE2 | DRIVING_SELECTOR_2 | PULL_DOWN | SCHMITT_TRIGGER_DISABLE | SLEW_RATE_DISABLE)			//SD_CDATA1_2  AH36
			(PIN96 | FUNCTION_MODE2 | DRIVING_SELECTOR_2 | PULL_DOWN | SCHMITT_TRIGGER_DISABLE | SLEW_RATE_DISABLE)			//SD_CDATA1_3  AH37
			(PIN97 | FUNCTION_MODE2 | DRIVING_SELECTOR_2 | PULL_DOWN | SCHMITT_TRIGGER_DISABLE | SLEW_RATE_DISABLE)			//SD_CCLK_OUT1  AJ36
			(PIN98 | FUNCTION_MODE2 | DRIVING_SELECTOR_2 | PULL_DOWN | SCHMITT_TRIGGER_DISABLE | SLEW_RATE_DISABLE)			//SD_CCMD1  AJ37
			
			//GPIO
			(PIN99 | FUNCTION_MODE0 | DRIVING_SELECTOR_2 | PULL_DOWN | SCHMITT_TRIGGER_DISABLE | SLEW_RATE_DISABLE)			//GPIO_A3_5  G37
			(PIN100 | FUNCTION_MODE0 | DRIVING_SELECTOR_2 | PULL_DOWN | SCHMITT_TRIGGER_DISABLE | SLEW_RATE_DISABLE)		//GPIO_A3_6  G36
			(PIN101 | FUNCTION_MODE0 | DRIVING_SELECTOR_2 | PULL_DOWN | SCHMITT_TRIGGER_DISABLE | SLEW_RATE_DISABLE)		//GPIO_A3_7  1C20
			
			//SD2
			(PIN102 | FUNCTION_MODE2 | DRIVING_SELECTOR_2 | PULL_DOWN | SCHMITT_TRIGGER_DISABLE | SLEW_RATE_DISABLE)		//SD_CDATA2_0  1V20
			(PIN103 | FUNCTION_MODE2 | DRIVING_SELECTOR_2 | PULL_DOWN | SCHMITT_TRIGGER_DISABLE | SLEW_RATE_DISABLE)		//SD_CDATA2_1  1W20
			(PIN104 | FUNCTION_MODE2 | DRIVING_SELECTOR_2 | PULL_DOWN | SCHMITT_TRIGGER_DISABLE | SLEW_RATE_DISABLE)		//SD_CDATA2_2  1U20
			(PIN105 | FUNCTION_MODE2 | DRIVING_SELECTOR_2 | PULL_DOWN | SCHMITT_TRIGGER_DISABLE | SLEW_RATE_DISABLE)		//SD_CDATA2_3  1U19
			(PIN106 | FUNCTION_MODE2 | DRIVING_SELECTOR_2 | PULL_DOWN | SCHMITT_TRIGGER_DISABLE | SLEW_RATE_DISABLE)		//SD_CCLK_OUT2  1V19
			(PIN107 | FUNCTION_MODE2 | DRIVING_SELECTOR_2 | PULL_DOWN | SCHMITT_TRIGGER_DISABLE | SLEW_RATE_DISABLE)		//SD_CCMD2  1U18
			
			//GPIO
			(PIN109 | FUNCTION_MODE0 | DRIVING_SELECTOR_2 | PULL_DOWN | SCHMITT_TRIGGER_DISABLE | SLEW_RATE_DISABLE)		//GPIO_B0_7  1C19
			(PIN110 | FUNCTION_MODE0 | DRIVING_SELECTOR_2 | PULL_DOWN | SCHMITT_TRIGGER_DISABLE | SLEW_RATE_DISABLE)		//GPIO_A2_0  H37
			
			//EMMC
			(PIN111 | FUNCTION_MODE2 | DRIVING_SELECTOR_0 | PULL_DOWN | SCHMITT_TRIGGER_DISABLE | SLEW_RATE_DISABLE)		//EMMC_CCLK_OUT  AG2
			(PIN112 | FUNCTION_MODE2 | DRIVING_SELECTOR_2 | PULL_DOWN | SCHMITT_TRIGGER_DISABLE | SLEW_RATE_DISABLE)		//EMMC_CCMD  
			(PIN113 | FUNCTION_MODE2 | DRIVING_SELECTOR_2 | PULL_DOWN | SCHMITT_TRIGGER_DISABLE | SLEW_RATE_DISABLE)		//EMMC_PWR  
			(PIN114 | FUNCTION_MODE2 | DRIVING_SELECTOR_0 | PULL_DOWN | SCHMITT_TRIGGER_DISABLE | SLEW_RATE_DISABLE)		//EMMC_D0  
			(PIN115 | FUNCTION_MODE2 | DRIVING_SELECTOR_0 | PULL_DOWN | SCHMITT_TRIGGER_DISABLE | SLEW_RATE_DISABLE)		//EMMC_D1  
			(PIN116 | FUNCTION_MODE2 | DRIVING_SELECTOR_0 | PULL_DOWN | SCHMITT_TRIGGER_DISABLE | SLEW_RATE_DISABLE)		//EMMC_D2  
			(PIN117 | FUNCTION_MODE2 | DRIVING_SELECTOR_0 | PULL_DOWN | SCHMITT_TRIGGER_DISABLE | SLEW_RATE_DISABLE)		//EMMC_D3  
			(PIN118 | FUNCTION_MODE2 | DRIVING_SELECTOR_0 | PULL_DOWN | SCHMITT_TRIGGER_DISABLE | SLEW_RATE_DISABLE)		//EMMC_D4  
			(PIN119 | FUNCTION_MODE2 | DRIVING_SELECTOR_0 | PULL_DOWN | SCHMITT_TRIGGER_DISABLE | SLEW_RATE_DISABLE)		//EMMC_D5  
			(PIN120 | FUNCTION_MODE2 | DRIVING_SELECTOR_0 | PULL_DOWN | SCHMITT_TRIGGER_DISABLE | SLEW_RATE_DISABLE)		//EMMC_D6  
			(PIN121 | FUNCTION_MODE2 | DRIVING_SELECTOR_0 | PULL_DOWN | SCHMITT_TRIGGER_DISABLE | SLEW_RATE_DISABLE)		//EMMC_D7  1U2
			
			//GPIO
			(PIN123 | FUNCTION_MODE4 | DRIVING_SELECTOR_2 | PULL_DOWN | SCHMITT_TRIGGER_DISABLE | SLEW_RATE_DISABLE)		//GPIO_C0_0  1E17
			(PIN124 | FUNCTION_MODE4 | DRIVING_SELECTOR_2 | PULL_DOWN | SCHMITT_TRIGGER_DISABLE | SLEW_RATE_DISABLE)		//GPIO_C0_1  1F17
			(PIN125 | FUNCTION_MODE4 | DRIVING_SELECTOR_2 | PULL_DOWN | SCHMITT_TRIGGER_DISABLE | SLEW_RATE_DISABLE)		//GPIO_C0_2  1E18
			(PIN126 | FUNCTION_MODE4 | DRIVING_SELECTOR_2 | PULL_UP | SCHMITT_TRIGGER_DISABLE | SLEW_RATE_DISABLE)			//GPIO_C0_3  1F19
			(PIN127 | FUNCTION_MODE4 | DRIVING_SELECTOR_2 | PULL_DOWN | SCHMITT_TRIGGER_DISABLE | SLEW_RATE_DISABLE)		//GPIO_D1_4  L36
			(PIN128 | FUNCTION_MODE4 | DRIVING_SELECTOR_2 | PULL_UP | SCHMITT_TRIGGER_DISABLE | SLEW_RATE_DISABLE)			//GPIO_D1_5  L37
			(PIN129 | FUNCTION_MODE4 | DRIVING_SELECTOR_2 | PULL_DOWN | SCHMITT_TRIGGER_DISABLE | SLEW_RATE_DISABLE)		//GPIO_D1_6  M36
			(PIN130 | FUNCTION_MODE4 | DRIVING_SELECTOR_2 | PULL_DOWN | SCHMITT_TRIGGER_DISABLE | SLEW_RATE_DISABLE)		//GPIO_D1_7  N36
			(PIN131 | FUNCTION_MODE4 | DRIVING_SELECTOR_2 | PULL_DOWN | SCHMITT_TRIGGER_DISABLE | SLEW_RATE_DISABLE)		//GPIO_B2_0  N37
			(PIN132 | FUNCTION_MODE4 | DRIVING_SELECTOR_2 | PULL_DOWN | SCHMITT_TRIGGER_DISABLE | SLEW_RATE_DISABLE)		//GPIO_B2_1  P36
			
			//I2C3
			(PIN133 | FUNCTION_MODE1 | DRIVING_SELECTOR_2 | PULL_DOWN | SCHMITT_TRIGGER_DISABLE | SLEW_RATE_DISABLE)		//I2C_SDA3  P37
			(PIN134 | FUNCTION_MODE1 | DRIVING_SELECTOR_2 | PULL_DOWN | SCHMITT_TRIGGER_DISABLE | SLEW_RATE_DISABLE)		//I2C_SCLK3  1J18
			
			//PWM5
			(PIN135 | FUNCTION_MODE6 | DRIVING_SELECTOR_2 | PULL_DOWN | SCHMITT_TRIGGER_DISABLE | SLEW_RATE_DISABLE)		//PWM5  1H18
			
			//GPIO
			(PIN136 | FUNCTION_MODE4 | DRIVING_SELECTOR_2 | PULL_DOWN | SCHMITT_TRIGGER_DISABLE | SLEW_RATE_DISABLE)  		//GPIO_B2_5  1J19     
			(PIN137 | FUNCTION_MODE4 | DRIVING_SELECTOR_2 | PULL_DOWN | SCHMITT_TRIGGER_DISABLE | SLEW_RATE_DISABLE)		//GPIO_A0_3  1H19
			(PIN138 | FUNCTION_MODE4 | DRIVING_SELECTOR_2 | PULL_DOWN | SCHMITT_TRIGGER_DISABLE | SLEW_RATE_DISABLE)		//GPIO_A0_4  1J20
			
			//QSPI
			(PIN139 | FUNCTION_MODE1 | DRIVING_SELECTOR_2 | PULL_DOWN | SCHMITT_TRIGGER_DISABLE | SLEW_RATE_DISABLE)		//QSPI_CS_N_1  1H20
			(PIN140 | FUNCTION_MODE0 | DRIVING_SELECTOR_2 | PULL_DOWN | SCHMITT_TRIGGER_DISABLE | SLEW_RATE_DISABLE)		//QSPI_SCK  A23
			(PIN141 | FUNCTION_MODE0 | DRIVING_SELECTOR_2 | PULL_DOWN | SCHMITT_TRIGGER_DISABLE | SLEW_RATE_DISABLE)		//QSPI_CS_N  A22
			(PIN142 | FUNCTION_MODE0 | DRIVING_SELECTOR_2 | PULL_DOWN | SCHMITT_TRIGGER_DISABLE | SLEW_RATE_DISABLE)		//QSPI_DATA_0  B22
			(PIN143 | FUNCTION_MODE0 | DRIVING_SELECTOR_2 | PULL_DOWN | SCHMITT_TRIGGER_DISABLE | SLEW_RATE_DISABLE)		//QSPI_DATA_1  B21	
			
			//GPIO
			(PIN144 | FUNCTION_MODE0 | DRIVING_SELECTOR_2 | PULL_UP | SCHMITT_TRIGGER_DISABLE | SLEW_RATE_DISABLE)			//GPIO_D3_4  T36
			(PIN145 | FUNCTION_MODE0 | DRIVING_SELECTOR_2 | PULL_DOWN | SCHMITT_TRIGGER_DISABLE | SLEW_RATE_DISABLE)		//GPIO_D3_5  1D18
			(PIN146 | FUNCTION_MODE0 | DRIVING_SELECTOR_2 | PULL_DOWN | SCHMITT_TRIGGER_DISABLE | SLEW_RATE_DISABLE)		//GPIO_D3_6  1F18
			(PIN147 | FUNCTION_MODE0 | DRIVING_SELECTOR_2 | PULL_DOWN | SCHMITT_TRIGGER_DISABLE | SLEW_RATE_DISABLE)		//GPIO_D3_7  1E19
			(PIN148 | FUNCTION_MODE0 | DRIVING_SELECTOR_2 | PULL_DOWN | SCHMITT_TRIGGER_DISABLE | SLEW_RATE_DISABLE)		//GPIO_D2_0  1D20
			(PIN149 | FUNCTION_MODE0 | DRIVING_SELECTOR_2 | PULL_DOWN | SCHMITT_TRIGGER_DISABLE | SLEW_RATE_DISABLE)		//GPIO_D2_1  T37
			(PIN150 | FUNCTION_MODE0 | DRIVING_SELECTOR_2 | PULL_UP | SCHMITT_TRIGGER_DISABLE | SLEW_RATE_DISABLE)			//GPIO_D2_2  U37
			(PIN151 | FUNCTION_MODE0 | DRIVING_SELECTOR_2 | PULL_DOWN | SCHMITT_TRIGGER_DISABLE | SLEW_RATE_DISABLE)		//GPIO_D2_3  U36
			(PIN152 | FUNCTION_MODE0 | DRIVING_SELECTOR_2 | PULL_DOWN | SCHMITT_TRIGGER_DISABLE | SLEW_RATE_DISABLE)		//GPIO_D2_4  V36
			(PIN153 | FUNCTION_MODE0 | DRIVING_SELECTOR_2 | PULL_DOWN | SCHMITT_TRIGGER_DISABLE | SLEW_RATE_DISABLE)        //GPIO_D2_5  W36
			(PIN154 | FUNCTION_MODE0 | DRIVING_SELECTOR_2 | PULL_DOWN | SCHMITT_TRIGGER_DISABLE | SLEW_RATE_DISABLE)		//GPIO_D2_6  1D19
			(PIN155 | FUNCTION_MODE0 | DRIVING_SELECTOR_2 | PULL_DOWN | SCHMITT_TRIGGER_DISABLE | SLEW_RATE_DISABLE)		//GPIO_D2_7  W37
			
			(PIN156 | FUNCTION_MODE3 | DRIVING_SELECTOR_2 | PULL_UP | SCHMITT_TRIGGER_DISABLE | SLEW_RATE_DISABLE)		//WDT  Y37
			
			(PIN157 | FUNCTION_MODE0 | DRIVING_SELECTOR_2 | PULL_DOWN | SCHMITT_TRIGGER_DISABLE | SLEW_RATE_DISABLE)		//GPIO_D0_1  Y36
			(PIN158 | FUNCTION_MODE0 | DRIVING_SELECTOR_2 | PULL_DOWN | SCHMITT_TRIGGER_DISABLE | SLEW_RATE_DISABLE)		//GPIO_D0_2  AA36
			
			//UART0
			(PIN159 | FUNCTION_MODE0 | DRIVING_SELECTOR_2 | PULL_DOWN | SCHMITT_TRIGGER_DISABLE | SLEW_RATE_DISABLE)		//UART_SIN0  1L20
			(PIN160 | FUNCTION_MODE0 | DRIVING_SELECTOR_2 | PULL_DOWN | SCHMITT_TRIGGER_DISABLE | SLEW_RATE_DISABLE)		//UART_SOUT0  1M20
			
			(PIN161 | FUNCTION_MODE0 | DRIVING_SELECTOR_2 | PULL_DOWN | SCHMITT_TRIGGER_DISABLE | SLEW_RATE_DISABLE)		//GPIO_D0_3  1F20
			
			//UART3
			(PIN163 | FUNCTION_MODE2 | DRIVING_SELECTOR_2 | PULL_DOWN | SCHMITT_TRIGGER_DISABLE | SLEW_RATE_DISABLE)		//UART_SIN3  1L18
			(PIN164 | FUNCTION_MODE2 | DRIVING_SELECTOR_2 | PULL_DOWN | SCHMITT_TRIGGER_DISABLE | SLEW_RATE_DISABLE)		//UART_SOUT3  1M19
			
			//UART4
			(PIN165 | FUNCTION_MODE2 | DRIVING_SELECTOR_2 | PULL_DOWN | SCHMITT_TRIGGER_DISABLE | SLEW_RATE_DISABLE)		//UART_SIN4  1M18
			(PIN166 | FUNCTION_MODE2 | DRIVING_SELECTOR_2 | PULL_DOWN | SCHMITT_TRIGGER_DISABLE | SLEW_RATE_DISABLE)		//UART_SOUT4  AB37
			
			(PIN167 | FUNCTION_MODE0 | DRIVING_SELECTOR_2 | PULL_DOWN | SCHMITT_TRIGGER_DISABLE | SLEW_RATE_DISABLE)		//GPIO_B3_4  AC36
			(PIN169 | FUNCTION_MODE2 | DRIVING_SELECTOR_2 | PULL_DOWN | SCHMITT_TRIGGER_DISABLE | SLEW_RATE_DISABLE)		//GPIO_B3_6  AD36
			(PIN170 | FUNCTION_MODE2 | DRIVING_SELECTOR_2 | PULL_DOWN | SCHMITT_TRIGGER_DISABLE | SLEW_RATE_DISABLE)		//GPIO_B3_7  AE36
			(PIN171 | FUNCTION_MODE0 | DRIVING_SELECTOR_2 | PULL_DOWN | SCHMITT_TRIGGER_DISABLE | SLEW_RATE_DISABLE)		//GPIO_D0_5  1E20
			
			(PIN172 | FUNCTION_MODE2 | DRIVING_SELECTOR_2 | PULL_DOWN | SCHMITT_TRIGGER_DISABLE | SLEW_RATE_DISABLE)		//CAN_TXD2  K36
			
			(PIN173 | FUNCTION_MODE0 | DRIVING_SELECTOR_2 | PULL_DOWN | SCHMITT_TRIGGER_DISABLE | SLEW_RATE_DISABLE)		//GPIO_D0_7  J36
			(PIN174 | FUNCTION_MODE0 | DRIVING_SELECTOR_2 | PULL_DOWN | SCHMITT_TRIGGER_DISABLE | SLEW_RATE_DISABLE)		//GPIO_C3_0  K37
			
			//GBE
			(PIN175 | FUNCTION_MODE2 | DRIVING_SELECTOR_3 | PULL_DOWN | SCHMITT_TRIGGER_DISABLE | SLEW_RATE_DISABLE)		//GBE_TXC  1P2
			(PIN176 | FUNCTION_MODE2 | DRIVING_SELECTOR_2 | PULL_DOWN | SCHMITT_TRIGGER_DISABLE | SLEW_RATE_DISABLE)
			(PIN177 | FUNCTION_MODE2 | DRIVING_SELECTOR_2 | PULL_DOWN | SCHMITT_TRIGGER_DISABLE | SLEW_RATE_DISABLE)
			(PIN178 | FUNCTION_MODE2 | DRIVING_SELECTOR_2 | PULL_DOWN | SCHMITT_TRIGGER_DISABLE | SLEW_RATE_DISABLE)
			(PIN179 | FUNCTION_MODE2 | DRIVING_SELECTOR_2 | PULL_DOWN | SCHMITT_TRIGGER_DISABLE | SLEW_RATE_DISABLE)
			(PIN180 | FUNCTION_MODE2 | DRIVING_SELECTOR_2 | PULL_DOWN | SCHMITT_TRIGGER_DISABLE | SLEW_RATE_DISABLE)
			(PIN181 | FUNCTION_MODE2 | DRIVING_SELECTOR_2 | PULL_DOWN | SCHMITT_TRIGGER_DISABLE | SLEW_RATE_DISABLE)
			(PIN182 | FUNCTION_MODE2 | DRIVING_SELECTOR_2 | PULL_DOWN | SCHMITT_TRIGGER_DISABLE | SLEW_RATE_DISABLE)
			(PIN183 | FUNCTION_MODE2 | DRIVING_SELECTOR_2 | PULL_DOWN | SCHMITT_TRIGGER_DISABLE | SLEW_RATE_DISABLE)
			(PIN184 | FUNCTION_MODE2 | DRIVING_SELECTOR_2 | PULL_DOWN | SCHMITT_TRIGGER_DISABLE | SLEW_RATE_DISABLE)
			(PIN185 | FUNCTION_MODE2 | DRIVING_SELECTOR_2 | PULL_DOWN | SCHMITT_TRIGGER_DISABLE | SLEW_RATE_DISABLE)
			(PIN186 | FUNCTION_MODE2 | DRIVING_SELECTOR_2 | PULL_DOWN | SCHMITT_TRIGGER_DISABLE | SLEW_RATE_DISABLE)
			(PIN187 | FUNCTION_MODE2 | DRIVING_SELECTOR_2 | PULL_DOWN | SCHMITT_TRIGGER_DISABLE | SLEW_RATE_DISABLE)
			(PIN188 | FUNCTION_MODE2 | DRIVING_SELECTOR_2 | PULL_DOWN | SCHMITT_TRIGGER_DISABLE | SLEW_RATE_DISABLE)
			(PIN189 | FUNCTION_MODE2 | DRIVING_SELECTOR_2 | PULL_DOWN | SCHMITT_TRIGGER_DISABLE | SLEW_RATE_DISABLE)
			(PIN190 | FUNCTION_MODE2 | DRIVING_SELECTOR_2 | PULL_DOWN | SCHMITT_TRIGGER_DISABLE | SLEW_RATE_DISABLE)
			(PIN191 | FUNCTION_MODE2 | DRIVING_SELECTOR_2 | PULL_DOWN | SCHMITT_TRIGGER_DISABLE | SLEW_RATE_DISABLE)		//GBE_RSTN  AA1
		>;
		pb-msc-cfgs = <
			(PB_MSC_BIT0  | PB_MSC_REG_PIN_V18)  // PB085_086, PB089_092
			(PB_MSC_BIT1  | PB_MSC_REG_PIN_V18)  // PB093_098
			(PB_MSC_BIT2  | PB_MSC_REG_PIN_V18)  // PB102_107
			(PB_MSC_BIT3  | PB_MSC_REG_PIN_V33)  // PB111_116
			(PB_MSC_BIT4  | PB_MSC_REG_PIN_V33)  // PB117_121
			(PB_MSC_BIT5  | PB_MSC_REG_PIN_V33)  // PB002_025
			(PB_MSC_BIT6  | PB_MSC_REG_PIN_V18)  // PB026_049
			(PB_MSC_BIT7  | PB_MSC_REG_PIN_V33)  // PB050_081
			(PB_MSC_BIT8  | PB_MSC_REG_PIN_V33)  // PB082_083, PB140_143
			(PB_MSC_BIT9  | PB_MSC_REG_PIN_V33)  // PB084, PB087_088, PB099_101, PB108_110, PB122_139, PB144_174, PB192
			(PB_MSC_BIT10 | PB_MSC_REG_PIN_V33)  // PB175_191
		>;
	};
};
