#include "artosyn-ar9301-ddr4.dtsi"

&dmc {
	user-modify0 =	<0		// params->type
			1200		// params->freq0
			1200		// params->freq1
			0x800000	// params->density
			0		// params->ddr_hbm
			0		// params->mr1_odic
			1		// params->mr1_rtt_nom
			1		// params->mr4_rdpreamble
			1		// params->mr4_wrpreamble
			0		// phy-input-basic->DramType
			4		// phy-input-basic->NumDbyte
			4		// phy-input-basic->NumActiveDbyteDfi0
			1		// phy-input-basic->NumPStates
			1200		// phy-input-basic->Frequency[0]
			1200		// phy-input-basic->Frequency[1]
			800		// phy-input-basic->Frequency[2]
			600		// phy-input-basic->Frequency[3]
			1		// phy-input-advanced->D4RxPreambleLength[0]
			1		// phy-input-advanced->D4RxPreambleLength[1]
			0		// phy-input-advanced->D4RxPreambleLength[2]
			0		// phy-input-advanced->D4RxPreambleLength[3]
			1		// phy-input-advanced->D4TxPreambleLength[0]
			1		// phy-input-advanced->D4TxPreambleLength[1]
			0		// phy-input-advanced->D4TxPreambleLength[2]
			0		// phy-input-advanced->D4TxPreambleLength[3]
			0x3c		// phy-input-advanced->ODTImpedance[0]
			0x3c		// phy-input-advanced->ODTImpedance[1]
			0x3c		// phy-input-advanced->ODTImpedance[2]
			0x3c		// phy-input-advanced->ODTImpedance[3]
			0x28		// phy-input-advanced->TxImpedance[0]
			0x28		// phy-input-advanced->TxImpedance[1]
			0x28		// phy-input-advanced->TxImpedance[2]
			0x28		// phy-input-advanced->TxImpedance[3]
			0x28		// phy-input-advanced->ATxImpedance
			0x0		// phy-pll-config->ssc_en
			0x3		// phy-pll-config->ssc_divn
			0x1		// phy-pll-config->ssc_num_step
			0x4		// phy-pll-config->ssc_kdelta
			0x0		// phy-pll-config->ssc_mode
			0x0             // runtimeConfig->skip_train
			0x0		// TrainSequenceCtrl
			0x00000008	// int Manual RxPBDly[4][2]   BYTE0 NIBBLE0
			0x00000009	// BYTE0 NIBBLE1
			0x00000006	// BYTE1 NIBBLE0
			0x0000000F	// BYTE1 NIBBLE1
			0x0000000c	// BYTE2 NIBBLE0
			0x0000000c	// BYTE2 NIBBLE1
			0x0000000c	// BYTE3 NIBBLE0
			0x0000000c	// BYTE3 NIBBLE1
			0x0000000a	// int RxClkDly[4][2]        BYTE0 NIBBLE0
			0x00000008	// BYTE0 NIBBLE1
			0x00000008	// BYTE1 NIBBLE0
			0x0000000a	// BYTE1 NIBBLE1
			0x00000008	// BYTE2 NIBBLE0
			0x00000008	// BYTE2 NIBBLE1
			0x00000008	// BYTE3 NIBBLE0
			0x00000008	// BYTE3 NIBBLE1
		>;
};
