#include <dt-bindings/pinctrl/pinctrl-ar9301.h>

&soc {
	pinctrl {
		compatible = "artosyn,ar9301-pinctrl";
		reg = <0x01073000 0x00000108	// pb_sw_reg_base
		       0x01073130 0x00000060>;	// pad_func_sel_base
		pinctrl-cfgs = <
			//vbus power
			(PIN127 | FUNCTION_MODE0 | DRIVING_SELECTOR_2 | PULL_DOWN | SCHMITT_TRIGGER_DISABLE | SLEW_RATE_DISABLE)
			(PIN128 | FUNCTION_MODE0 | DRIVING_SELECTOR_2 | PULL_DOWN | SCHMITT_TRIGGER_DISABLE | SLEW_RATE_DISABLE)
			(PIN129 | FUNCTION_MODE0 | DRIVING_SELECTOR_2 | PULL_DOWN | SCHMITT_TRIGGER_DISABLE | SLEW_RATE_DISABLE)

			// dvp1 in
			(PIN2 | FUNCTION_MODE0 | DRIVING_SELECTOR_2 | PULL_DOWN | SCHMITT_TRIGGER_DISABLE | SLEW_RATE_DISABLE)
			(PIN3 | FUNCTION_MODE0 | DRIVING_SELECTOR_2 | PULL_DOWN | SCHMITT_TRIGGER_DISABLE | SLEW_RATE_DISABLE)
			(PIN4 | FUNCTION_MODE0 | DRIVING_SELECTOR_2 | PULL_DOWN | SCHMITT_TRIGGER_DISABLE | SLEW_RATE_DISABLE)
			(PIN5 | FUNCTION_MODE0 | DRIVING_SELECTOR_2 | PULL_DOWN | SCHMITT_TRIGGER_DISABLE | SLEW_RATE_DISABLE)
			(PIN6 | FUNCTION_MODE0 | DRIVING_SELECTOR_2 | PULL_DOWN | SCHMITT_TRIGGER_DISABLE | SLEW_RATE_DISABLE)
			(PIN7 | FUNCTION_MODE0 | DRIVING_SELECTOR_2 | PULL_DOWN | SCHMITT_TRIGGER_DISABLE | SLEW_RATE_DISABLE)
			(PIN8 | FUNCTION_MODE0 | DRIVING_SELECTOR_2 | PULL_DOWN | SCHMITT_TRIGGER_DISABLE | SLEW_RATE_DISABLE)
			(PIN9 | FUNCTION_MODE0 | DRIVING_SELECTOR_2 | PULL_DOWN | SCHMITT_TRIGGER_DISABLE | SLEW_RATE_DISABLE)
			(PIN10 | FUNCTION_MODE0 | DRIVING_SELECTOR_2 | PULL_DOWN | SCHMITT_TRIGGER_DISABLE | SLEW_RATE_DISABLE)
			(PIN11 | FUNCTION_MODE0 | DRIVING_SELECTOR_2 | PULL_DOWN | SCHMITT_TRIGGER_DISABLE | SLEW_RATE_DISABLE)
			(PIN12 | FUNCTION_MODE0 | DRIVING_SELECTOR_2 | PULL_DOWN | SCHMITT_TRIGGER_DISABLE | SLEW_RATE_DISABLE)
			(PIN13 | FUNCTION_MODE0 | DRIVING_SELECTOR_2 | PULL_DOWN | SCHMITT_TRIGGER_DISABLE | SLEW_RATE_DISABLE)
			(PIN14 | FUNCTION_MODE0 | DRIVING_SELECTOR_2 | PULL_DOWN | SCHMITT_TRIGGER_DISABLE | SLEW_RATE_DISABLE)
			(PIN15 | FUNCTION_MODE0 | DRIVING_SELECTOR_2 | PULL_DOWN | SCHMITT_TRIGGER_DISABLE | SLEW_RATE_DISABLE)
			(PIN16 | FUNCTION_MODE0 | DRIVING_SELECTOR_2 | PULL_DOWN | SCHMITT_TRIGGER_DISABLE | SLEW_RATE_DISABLE)
			(PIN17 | FUNCTION_MODE0 | DRIVING_SELECTOR_2 | PULL_DOWN | SCHMITT_TRIGGER_DISABLE | SLEW_RATE_DISABLE)
			(PIN18 | FUNCTION_MODE0 | DRIVING_SELECTOR_2 | PULL_DOWN | SCHMITT_TRIGGER_DISABLE | SLEW_RATE_DISABLE)
			(PIN19 | FUNCTION_MODE0 | DRIVING_SELECTOR_2 | PULL_DOWN | SCHMITT_TRIGGER_DISABLE | SLEW_RATE_DISABLE)
			(PIN20 | FUNCTION_MODE0 | DRIVING_SELECTOR_2 | PULL_DOWN | SCHMITT_TRIGGER_DISABLE | SLEW_RATE_DISABLE)
			(PIN21 | FUNCTION_MODE0 | DRIVING_SELECTOR_2 | PULL_DOWN | SCHMITT_TRIGGER_DISABLE | SLEW_RATE_DISABLE)
			(PIN22 | FUNCTION_MODE0 | DRIVING_SELECTOR_2 | PULL_DOWN | SCHMITT_TRIGGER_DISABLE | SLEW_RATE_DISABLE)
			(PIN23 | FUNCTION_MODE2 | DRIVING_SELECTOR_2 | PULL_DOWN | SCHMITT_TRIGGER_DISABLE | SLEW_RATE_DISABLE)
			(PIN24 | FUNCTION_MODE2 | DRIVING_SELECTOR_2 | PULL_DOWN | SCHMITT_TRIGGER_DISABLE | SLEW_RATE_DISABLE)
			(PIN25 | FUNCTION_MODE2 | DRIVING_SELECTOR_2 | PULL_DOWN | SCHMITT_TRIGGER_DISABLE | SLEW_RATE_DISABLE)

			//dvp2 in
			(PIN26 | FUNCTION_MODE2 | DRIVING_SELECTOR_2 | PULL_DOWN | SCHMITT_TRIGGER_DISABLE | SLEW_RATE_DISABLE)
			(PIN27 | FUNCTION_MODE0 | DRIVING_SELECTOR_2 | PULL_DOWN | SCHMITT_TRIGGER_DISABLE | SLEW_RATE_DISABLE)
			(PIN28 | FUNCTION_MODE0 | DRIVING_SELECTOR_2 | PULL_DOWN | SCHMITT_TRIGGER_DISABLE | SLEW_RATE_DISABLE)
			(PIN29 | FUNCTION_MODE0 | DRIVING_SELECTOR_2 | PULL_DOWN | SCHMITT_TRIGGER_DISABLE | SLEW_RATE_DISABLE)
			(PIN30 | FUNCTION_MODE0 | DRIVING_SELECTOR_2 | PULL_DOWN | SCHMITT_TRIGGER_DISABLE | SLEW_RATE_DISABLE)
			(PIN31 | FUNCTION_MODE0 | DRIVING_SELECTOR_2 | PULL_DOWN | SCHMITT_TRIGGER_DISABLE | SLEW_RATE_DISABLE)
			(PIN32 | FUNCTION_MODE0 | DRIVING_SELECTOR_2 | PULL_DOWN | SCHMITT_TRIGGER_DISABLE | SLEW_RATE_DISABLE)
			(PIN33 | FUNCTION_MODE0 | DRIVING_SELECTOR_2 | PULL_DOWN | SCHMITT_TRIGGER_DISABLE | SLEW_RATE_DISABLE)
			(PIN34 | FUNCTION_MODE0 | DRIVING_SELECTOR_2 | PULL_DOWN | SCHMITT_TRIGGER_DISABLE | SLEW_RATE_DISABLE)
			(PIN35 | FUNCTION_MODE0 | DRIVING_SELECTOR_2 | PULL_DOWN | SCHMITT_TRIGGER_DISABLE | SLEW_RATE_DISABLE)
			(PIN36 | FUNCTION_MODE0 | DRIVING_SELECTOR_2 | PULL_DOWN | SCHMITT_TRIGGER_DISABLE | SLEW_RATE_DISABLE)
			(PIN37 | FUNCTION_MODE0 | DRIVING_SELECTOR_2 | PULL_DOWN | SCHMITT_TRIGGER_DISABLE | SLEW_RATE_DISABLE)
			(PIN38 | FUNCTION_MODE0 | DRIVING_SELECTOR_2 | PULL_DOWN | SCHMITT_TRIGGER_DISABLE | SLEW_RATE_DISABLE)
			(PIN39 | FUNCTION_MODE0 | DRIVING_SELECTOR_2 | PULL_DOWN | SCHMITT_TRIGGER_DISABLE | SLEW_RATE_DISABLE)
			(PIN40 | FUNCTION_MODE0 | DRIVING_SELECTOR_2 | PULL_DOWN | SCHMITT_TRIGGER_DISABLE | SLEW_RATE_DISABLE)
			(PIN41 | FUNCTION_MODE0 | DRIVING_SELECTOR_2 | PULL_DOWN | SCHMITT_TRIGGER_DISABLE | SLEW_RATE_DISABLE)
			(PIN42 | FUNCTION_MODE0 | DRIVING_SELECTOR_2 | PULL_DOWN | SCHMITT_TRIGGER_DISABLE | SLEW_RATE_DISABLE)
			(PIN43 | FUNCTION_MODE0 | DRIVING_SELECTOR_2 | PULL_DOWN | SCHMITT_TRIGGER_DISABLE | SLEW_RATE_DISABLE)
			(PIN44 | FUNCTION_MODE0 | DRIVING_SELECTOR_2 | PULL_DOWN | SCHMITT_TRIGGER_DISABLE | SLEW_RATE_DISABLE)
			(PIN45 | FUNCTION_MODE0 | DRIVING_SELECTOR_2 | PULL_DOWN | SCHMITT_TRIGGER_DISABLE | SLEW_RATE_DISABLE)
			(PIN46 | FUNCTION_MODE0 | DRIVING_SELECTOR_2 | PULL_DOWN | SCHMITT_TRIGGER_DISABLE | SLEW_RATE_DISABLE)
			(PIN47 | FUNCTION_MODE0 | DRIVING_SELECTOR_2 | PULL_DOWN | SCHMITT_TRIGGER_DISABLE | SLEW_RATE_DISABLE)
			(PIN48 | FUNCTION_MODE0 | DRIVING_SELECTOR_2 | PULL_DOWN | SCHMITT_TRIGGER_DISABLE | SLEW_RATE_DISABLE)
			(PIN49 | FUNCTION_MODE0 | DRIVING_SELECTOR_2 | PULL_DOWN | SCHMITT_TRIGGER_DISABLE | SLEW_RATE_DISABLE)

			// dvp out
			(PIN50 | FUNCTION_MODE2 | DRIVING_SELECTOR_2 | PULL_DOWN | SCHMITT_TRIGGER_DISABLE | SLEW_RATE_DISABLE)
			(PIN51 | FUNCTION_MODE2 | DRIVING_SELECTOR_2 | PULL_DOWN | SCHMITT_TRIGGER_DISABLE | SLEW_RATE_DISABLE)
			(PIN52 | FUNCTION_MODE2 | DRIVING_SELECTOR_2 | PULL_DOWN | SCHMITT_TRIGGER_DISABLE | SLEW_RATE_DISABLE)
			(PIN53 | FUNCTION_MODE2 | DRIVING_SELECTOR_2 | PULL_DOWN | SCHMITT_TRIGGER_DISABLE | SLEW_RATE_DISABLE)
			(PIN54 | FUNCTION_MODE2 | DRIVING_SELECTOR_2 | PULL_DOWN | SCHMITT_TRIGGER_DISABLE | SLEW_RATE_DISABLE)
			(PIN55 | FUNCTION_MODE2 | DRIVING_SELECTOR_2 | PULL_DOWN | SCHMITT_TRIGGER_DISABLE | SLEW_RATE_DISABLE)
			(PIN56 | FUNCTION_MODE2 | DRIVING_SELECTOR_2 | PULL_DOWN | SCHMITT_TRIGGER_DISABLE | SLEW_RATE_DISABLE)
			(PIN57 | FUNCTION_MODE2 | DRIVING_SELECTOR_2 | PULL_DOWN | SCHMITT_TRIGGER_DISABLE | SLEW_RATE_DISABLE)
			(PIN58 | FUNCTION_MODE2 | DRIVING_SELECTOR_2 | PULL_DOWN | SCHMITT_TRIGGER_DISABLE | SLEW_RATE_DISABLE)
			(PIN59 | FUNCTION_MODE2 | DRIVING_SELECTOR_2 | PULL_DOWN | SCHMITT_TRIGGER_DISABLE | SLEW_RATE_DISABLE)
			(PIN60 | FUNCTION_MODE2 | DRIVING_SELECTOR_2 | PULL_DOWN | SCHMITT_TRIGGER_DISABLE | SLEW_RATE_DISABLE)
			(PIN61 | FUNCTION_MODE2 | DRIVING_SELECTOR_2 | PULL_DOWN | SCHMITT_TRIGGER_DISABLE | SLEW_RATE_DISABLE)
			(PIN62 | FUNCTION_MODE2 | DRIVING_SELECTOR_2 | PULL_DOWN | SCHMITT_TRIGGER_DISABLE | SLEW_RATE_DISABLE)
			(PIN63 | FUNCTION_MODE2 | DRIVING_SELECTOR_2 | PULL_DOWN | SCHMITT_TRIGGER_DISABLE | SLEW_RATE_DISABLE)
			(PIN64 | FUNCTION_MODE2 | DRIVING_SELECTOR_2 | PULL_DOWN | SCHMITT_TRIGGER_DISABLE | SLEW_RATE_DISABLE)
			(PIN65 | FUNCTION_MODE2 | DRIVING_SELECTOR_2 | PULL_DOWN | SCHMITT_TRIGGER_DISABLE | SLEW_RATE_DISABLE)
			(PIN66 | FUNCTION_MODE2 | DRIVING_SELECTOR_2 | PULL_DOWN | SCHMITT_TRIGGER_DISABLE | SLEW_RATE_DISABLE)
			(PIN67 | FUNCTION_MODE2 | DRIVING_SELECTOR_2 | PULL_DOWN | SCHMITT_TRIGGER_DISABLE | SLEW_RATE_DISABLE)
			(PIN68 | FUNCTION_MODE2 | DRIVING_SELECTOR_2 | PULL_DOWN | SCHMITT_TRIGGER_DISABLE | SLEW_RATE_DISABLE)
			(PIN69 | FUNCTION_MODE2 | DRIVING_SELECTOR_2 | PULL_DOWN | SCHMITT_TRIGGER_DISABLE | SLEW_RATE_DISABLE)
			(PIN70 | FUNCTION_MODE2 | DRIVING_SELECTOR_2 | PULL_DOWN | SCHMITT_TRIGGER_DISABLE | SLEW_RATE_DISABLE)
			(PIN71 | FUNCTION_MODE2 | DRIVING_SELECTOR_2 | PULL_DOWN | SCHMITT_TRIGGER_DISABLE | SLEW_RATE_DISABLE)
			(PIN72 | FUNCTION_MODE2 | DRIVING_SELECTOR_2 | PULL_DOWN | SCHMITT_TRIGGER_DISABLE | SLEW_RATE_DISABLE)
			(PIN73 | FUNCTION_MODE2 | DRIVING_SELECTOR_2 | PULL_DOWN | SCHMITT_TRIGGER_DISABLE | SLEW_RATE_DISABLE)

			(PIN85 | FUNCTION_MODE2 | DRIVING_SELECTOR_2 | PULL_DOWN | SCHMITT_TRIGGER_DISABLE | SLEW_RATE_DISABLE)
			(PIN86 | FUNCTION_MODE2 | DRIVING_SELECTOR_2 | PULL_DOWN | SCHMITT_TRIGGER_DISABLE | SLEW_RATE_DISABLE)
			(PIN87 | FUNCTION_MODE2 | DRIVING_SELECTOR_2 | PULL_DOWN | SCHMITT_TRIGGER_DISABLE | SLEW_RATE_DISABLE)
			(PIN88 | FUNCTION_MODE0 | DRIVING_SELECTOR_2 | PULL_UP | SCHMITT_TRIGGER_DISABLE | SLEW_RATE_DISABLE)
			(PIN89 | FUNCTION_MODE2 | DRIVING_SELECTOR_2 | PULL_DOWN | SCHMITT_TRIGGER_DISABLE | SLEW_RATE_DISABLE)
			(PIN90 | FUNCTION_MODE2 | DRIVING_SELECTOR_2 | PULL_DOWN | SCHMITT_TRIGGER_DISABLE | SLEW_RATE_DISABLE)
			(PIN91 | FUNCTION_MODE2 | DRIVING_SELECTOR_2 | PULL_DOWN | SCHMITT_TRIGGER_DISABLE | SLEW_RATE_DISABLE)
			(PIN92 | FUNCTION_MODE2 | DRIVING_SELECTOR_2 | PULL_DOWN | SCHMITT_TRIGGER_DISABLE | SLEW_RATE_DISABLE)
			(PIN93 | FUNCTION_MODE0 | DRIVING_SELECTOR_2 | PULL_DOWN | SCHMITT_TRIGGER_DISABLE | SLEW_RATE_DISABLE)
			(PIN94 | FUNCTION_MODE0 | DRIVING_SELECTOR_2 | PULL_DOWN | SCHMITT_TRIGGER_DISABLE | SLEW_RATE_DISABLE)
			(PIN95 | FUNCTION_MODE0 | DRIVING_SELECTOR_2 | PULL_DOWN | SCHMITT_TRIGGER_DISABLE | SLEW_RATE_DISABLE)
			(PIN96 | FUNCTION_MODE0 | DRIVING_SELECTOR_2 | PULL_DOWN | SCHMITT_TRIGGER_DISABLE | SLEW_RATE_DISABLE)
			(PIN97 | FUNCTION_MODE0 | DRIVING_SELECTOR_2 | PULL_DOWN | SCHMITT_TRIGGER_DISABLE | SLEW_RATE_DISABLE)
			(PIN98 | FUNCTION_MODE0 | DRIVING_SELECTOR_2 | PULL_DOWN | SCHMITT_TRIGGER_DISABLE | SLEW_RATE_DISABLE)
			(PIN99 | FUNCTION_MODE5 | DRIVING_SELECTOR_2 | PULL_DOWN | SCHMITT_TRIGGER_DISABLE | SLEW_RATE_DISABLE)
			(PIN100 | FUNCTION_MODE5 | DRIVING_SELECTOR_2 | PULL_DOWN | SCHMITT_TRIGGER_DISABLE | SLEW_RATE_DISABLE)
			(PIN102 | FUNCTION_MODE0 | DRIVING_SELECTOR_2 | PULL_DOWN | SCHMITT_TRIGGER_DISABLE | SLEW_RATE_DISABLE)
			(PIN103 | FUNCTION_MODE0 | DRIVING_SELECTOR_2 | PULL_DOWN | SCHMITT_TRIGGER_DISABLE | SLEW_RATE_DISABLE)
			(PIN104 | FUNCTION_MODE0 | DRIVING_SELECTOR_2 | PULL_DOWN | SCHMITT_TRIGGER_DISABLE | SLEW_RATE_DISABLE)
			(PIN105 | FUNCTION_MODE0 | DRIVING_SELECTOR_2 | PULL_DOWN | SCHMITT_TRIGGER_DISABLE | SLEW_RATE_DISABLE)
			(PIN106 | FUNCTION_MODE2 | DRIVING_SELECTOR_2 | PULL_DOWN | SCHMITT_TRIGGER_DISABLE | SLEW_RATE_DISABLE)
			(PIN107 | FUNCTION_MODE2 | DRIVING_SELECTOR_2 | PULL_DOWN | SCHMITT_TRIGGER_DISABLE | SLEW_RATE_DISABLE)
			(PIN111 | FUNCTION_MODE2 | DRIVING_SELECTOR_2 | NO_PULL | SCHMITT_TRIGGER_DISABLE | SLEW_RATE_DISABLE)
			(PIN112 | FUNCTION_MODE2 | DRIVING_SELECTOR_2 | PULL_UP | SCHMITT_TRIGGER_DISABLE | SLEW_RATE_DISABLE)
			(PIN113 | FUNCTION_MODE2 | DRIVING_SELECTOR_2 | NO_PULL | SCHMITT_TRIGGER_DISABLE | SLEW_RATE_DISABLE)
			(PIN114 | FUNCTION_MODE2 | DRIVING_SELECTOR_2 | PULL_UP | SCHMITT_TRIGGER_DISABLE | SLEW_RATE_DISABLE)
			(PIN115 | FUNCTION_MODE2 | DRIVING_SELECTOR_2 | PULL_UP | SCHMITT_TRIGGER_DISABLE | SLEW_RATE_DISABLE)
			(PIN116 | FUNCTION_MODE2 | DRIVING_SELECTOR_2 | PULL_UP | SCHMITT_TRIGGER_DISABLE | SLEW_RATE_DISABLE)
			(PIN117 | FUNCTION_MODE2 | DRIVING_SELECTOR_2 | PULL_UP | SCHMITT_TRIGGER_DISABLE | SLEW_RATE_DISABLE)
			(PIN118 | FUNCTION_MODE2 | DRIVING_SELECTOR_2 | PULL_UP | SCHMITT_TRIGGER_DISABLE | SLEW_RATE_DISABLE)
			(PIN119 | FUNCTION_MODE2 | DRIVING_SELECTOR_2 | PULL_UP | SCHMITT_TRIGGER_DISABLE | SLEW_RATE_DISABLE)
			(PIN120 | FUNCTION_MODE2 | DRIVING_SELECTOR_2 | PULL_UP | SCHMITT_TRIGGER_DISABLE | SLEW_RATE_DISABLE)
			(PIN121 | FUNCTION_MODE2 | DRIVING_SELECTOR_2 | PULL_UP | SCHMITT_TRIGGER_DISABLE | SLEW_RATE_DISABLE)
			(PIN122 | FUNCTION_MODE2 | DRIVING_SELECTOR_2 | NO_PULL | SCHMITT_TRIGGER_DISABLE | SLEW_RATE_DISABLE)
			(PIN123 | FUNCTION_MODE2 | DRIVING_SELECTOR_2 | PULL_DOWN | SCHMITT_TRIGGER_DISABLE | SLEW_RATE_DISABLE)
			(PIN124 | FUNCTION_MODE2 | DRIVING_SELECTOR_2 | PULL_DOWN | SCHMITT_TRIGGER_DISABLE | SLEW_RATE_DISABLE)
			(PIN125 | FUNCTION_MODE2 | DRIVING_SELECTOR_2 | PULL_DOWN | SCHMITT_TRIGGER_DISABLE | SLEW_RATE_DISABLE)
			(PIN126 | FUNCTION_MODE2 | DRIVING_SELECTOR_2 | PULL_DOWN | SCHMITT_TRIGGER_DISABLE | SLEW_RATE_DISABLE)
			(PIN133 | FUNCTION_MODE2 | DRIVING_SELECTOR_2 | PULL_DOWN | SCHMITT_TRIGGER_DISABLE | SLEW_RATE_DISABLE)
			(PIN134 | FUNCTION_MODE2 | DRIVING_SELECTOR_2 | PULL_DOWN | SCHMITT_TRIGGER_DISABLE | SLEW_RATE_DISABLE)
			(PIN135 | FUNCTION_MODE2 | DRIVING_SELECTOR_2 | PULL_DOWN | SCHMITT_TRIGGER_DISABLE | SLEW_RATE_DISABLE)
			(PIN136 | FUNCTION_MODE2 | DRIVING_SELECTOR_2 | PULL_DOWN | SCHMITT_TRIGGER_DISABLE | SLEW_RATE_DISABLE)
			(PIN137 | FUNCTION_MODE1 | DRIVING_SELECTOR_2 | PULL_DOWN | SCHMITT_TRIGGER_DISABLE | SLEW_RATE_DISABLE)
			(PIN138 | FUNCTION_MODE1 | DRIVING_SELECTOR_2 | PULL_DOWN | SCHMITT_TRIGGER_DISABLE | SLEW_RATE_DISABLE) //sensor_mclk1
			(PIN140 | FUNCTION_MODE5 | DRIVING_SELECTOR_2 | PULL_DOWN | SCHMITT_TRIGGER_DISABLE | SLEW_RATE_DISABLE)
			(PIN141 | FUNCTION_MODE5 | DRIVING_SELECTOR_2 | PULL_DOWN | SCHMITT_TRIGGER_DISABLE | SLEW_RATE_DISABLE) //A22 GPIO_B3_3 TP2803FC_RST
			(PIN142 | FUNCTION_MODE5 | DRIVING_SELECTOR_2 | PULL_DOWN | SCHMITT_TRIGGER_DISABLE | SLEW_RATE_DISABLE)
			(PIN143 | FUNCTION_MODE5 | DRIVING_SELECTOR_2 | PULL_DOWN | SCHMITT_TRIGGER_DISABLE | SLEW_RATE_DISABLE)
			(PIN145 | FUNCTION_MODE0 | DRIVING_SELECTOR_2 | PULL_DOWN | SCHMITT_TRIGGER_DISABLE | SLEW_RATE_DISABLE)
			(PIN146 | FUNCTION_MODE0 | DRIVING_SELECTOR_2 | PULL_DOWN | SCHMITT_TRIGGER_DISABLE | SLEW_RATE_DISABLE)
			(PIN147 | FUNCTION_MODE0 | DRIVING_SELECTOR_2 | PULL_DOWN | SCHMITT_TRIGGER_DISABLE | SLEW_RATE_DISABLE)
			(PIN148 | FUNCTION_MODE0 | DRIVING_SELECTOR_2 | PULL_DOWN | SCHMITT_TRIGGER_DISABLE | SLEW_RATE_DISABLE)
			(PIN149 | FUNCTION_MODE2 | DRIVING_SELECTOR_2 | PULL_DOWN | SCHMITT_TRIGGER_DISABLE | SLEW_RATE_DISABLE)
			(PIN150 | FUNCTION_MODE2 | DRIVING_SELECTOR_2 | PULL_DOWN | SCHMITT_TRIGGER_DISABLE | SLEW_RATE_DISABLE)
			(PIN151 | FUNCTION_MODE2 | DRIVING_SELECTOR_2 | PULL_UP | SCHMITT_TRIGGER_DISABLE | SLEW_RATE_DISABLE) //U36 I2C_SDA0
			(PIN152 | FUNCTION_MODE2 | DRIVING_SELECTOR_2 | PULL_UP | SCHMITT_TRIGGER_DISABLE | SLEW_RATE_DISABLE) //V36 I2C_SCLK0
			(PIN153 | FUNCTION_MODE2 | DRIVING_SELECTOR_2 | PULL_UP | SCHMITT_TRIGGER_DISABLE | SLEW_RATE_DISABLE)
			(PIN154 | FUNCTION_MODE2 | DRIVING_SELECTOR_2 | PULL_UP | SCHMITT_TRIGGER_DISABLE | SLEW_RATE_DISABLE)
			(PIN155 | FUNCTION_MODE2 | DRIVING_SELECTOR_2 | PULL_UP | SCHMITT_TRIGGER_DISABLE | SLEW_RATE_DISABLE)
			(PIN156 | FUNCTION_MODE2 | DRIVING_SELECTOR_2 | PULL_UP | SCHMITT_TRIGGER_DISABLE | SLEW_RATE_DISABLE)
			(PIN157 | FUNCTION_MODE2 | DRIVING_SELECTOR_2 | PULL_UP   | SCHMITT_TRIGGER_DISABLE | SLEW_RATE_DISABLE)
			(PIN158 | FUNCTION_MODE2 | DRIVING_SELECTOR_2 | PULL_UP   | SCHMITT_TRIGGER_DISABLE | SLEW_RATE_DISABLE)
			(PIN159 | FUNCTION_MODE0 | DRIVING_SELECTOR_2 | PULL_DOWN | SCHMITT_TRIGGER_DISABLE | SLEW_RATE_DISABLE)
			(PIN160 | FUNCTION_MODE0 | DRIVING_SELECTOR_2 | PULL_DOWN | SCHMITT_TRIGGER_DISABLE | SLEW_RATE_DISABLE)
			(PIN165 | FUNCTION_MODE0 | DRIVING_SELECTOR_2 | PULL_DOWN | SCHMITT_TRIGGER_DISABLE | SLEW_RATE_DISABLE)
			(PIN166 | FUNCTION_MODE0 | DRIVING_SELECTOR_2 | PULL_DOWN | SCHMITT_TRIGGER_DISABLE | SLEW_RATE_DISABLE)
			(PIN169 | FUNCTION_MODE2 | DRIVING_SELECTOR_2 | PULL_DOWN | SCHMITT_TRIGGER_DISABLE | SLEW_RATE_DISABLE)
			(PIN170 | FUNCTION_MODE2 | DRIVING_SELECTOR_2 | PULL_DOWN | SCHMITT_TRIGGER_DISABLE | SLEW_RATE_DISABLE)
			(PIN171 | FUNCTION_MODE0 | DRIVING_SELECTOR_2 | PULL_DOWN | SCHMITT_TRIGGER_DISABLE | SLEW_RATE_DISABLE)
			(PIN172 | FUNCTION_MODE2 | DRIVING_SELECTOR_2 | PULL_DOWN | SCHMITT_TRIGGER_DISABLE | SLEW_RATE_DISABLE)
			(PIN173 | FUNCTION_MODE2 | DRIVING_SELECTOR_2 | PULL_DOWN | SCHMITT_TRIGGER_DISABLE | SLEW_RATE_DISABLE)
			(PIN174 | FUNCTION_MODE2 | DRIVING_SELECTOR_2 | PULL_DOWN | SCHMITT_TRIGGER_DISABLE | SLEW_RATE_DISABLE)
			(PIN175 | FUNCTION_MODE2 | DRIVING_SELECTOR_2 | PULL_DOWN | SCHMITT_TRIGGER_DISABLE | SLEW_RATE_DISABLE)
			(PIN176 | FUNCTION_MODE2 | DRIVING_SELECTOR_2 | PULL_DOWN | SCHMITT_TRIGGER_DISABLE | SLEW_RATE_DISABLE)
			(PIN177 | FUNCTION_MODE2 | DRIVING_SELECTOR_2 | PULL_DOWN | SCHMITT_TRIGGER_DISABLE | SLEW_RATE_DISABLE)
			(PIN178 | FUNCTION_MODE2 | DRIVING_SELECTOR_2 | PULL_DOWN | SCHMITT_TRIGGER_DISABLE | SLEW_RATE_DISABLE)
			(PIN179 | FUNCTION_MODE2 | DRIVING_SELECTOR_2 | PULL_DOWN | SCHMITT_TRIGGER_DISABLE | SLEW_RATE_DISABLE)
			(PIN180 | FUNCTION_MODE2 | DRIVING_SELECTOR_2 | PULL_DOWN | SCHMITT_TRIGGER_DISABLE | SLEW_RATE_DISABLE)
			(PIN181 | FUNCTION_MODE2 | DRIVING_SELECTOR_2 | PULL_DOWN | SCHMITT_TRIGGER_DISABLE | SLEW_RATE_DISABLE)
			(PIN182 | FUNCTION_MODE2 | DRIVING_SELECTOR_2 | PULL_DOWN | SCHMITT_TRIGGER_DISABLE | SLEW_RATE_DISABLE)
			(PIN183 | FUNCTION_MODE2 | DRIVING_SELECTOR_2 | PULL_DOWN | SCHMITT_TRIGGER_DISABLE | SLEW_RATE_DISABLE)
			(PIN184 | FUNCTION_MODE2 | DRIVING_SELECTOR_2 | PULL_DOWN | SCHMITT_TRIGGER_DISABLE | SLEW_RATE_DISABLE)
			(PIN185 | FUNCTION_MODE2 | DRIVING_SELECTOR_2 | PULL_DOWN | SCHMITT_TRIGGER_DISABLE | SLEW_RATE_DISABLE)
			(PIN186 | FUNCTION_MODE2 | DRIVING_SELECTOR_2 | PULL_DOWN | SCHMITT_TRIGGER_DISABLE | SLEW_RATE_DISABLE)
			(PIN187 | FUNCTION_MODE2 | DRIVING_SELECTOR_2 | PULL_DOWN | SCHMITT_TRIGGER_DISABLE | SLEW_RATE_DISABLE)
			(PIN188 | FUNCTION_MODE2 | DRIVING_SELECTOR_2 | PULL_DOWN | SCHMITT_TRIGGER_DISABLE | SLEW_RATE_DISABLE)
			(PIN189 | FUNCTION_MODE2 | DRIVING_SELECTOR_2 | PULL_DOWN | SCHMITT_TRIGGER_DISABLE | SLEW_RATE_DISABLE)
			(PIN190 | FUNCTION_MODE2 | DRIVING_SELECTOR_2 | PULL_DOWN | SCHMITT_TRIGGER_DISABLE | SLEW_RATE_DISABLE)
			(PIN191 | FUNCTION_MODE2 | DRIVING_SELECTOR_2 | PULL_DOWN | SCHMITT_TRIGGER_DISABLE | SLEW_RATE_DISABLE)
			(PIN81 | FUNCTION_MODE0 | DRIVING_SELECTOR_2 | PULL_DOWN | SCHMITT_TRIGGER_DISABLE | SLEW_RATE_DISABLE)
			(PIN127 | FUNCTION_MODE4 | DRIVING_SELECTOR_2 | PULL_DOWN | SCHMITT_TRIGGER_DISABLE | SLEW_RATE_DISABLE)  // PIN_L36 GPIO_D1_4
			(PIN128 | FUNCTION_MODE4 | DRIVING_SELECTOR_2 | PULL_DOWN | SCHMITT_TRIGGER_DISABLE | SLEW_RATE_DISABLE)  // PIN_L37 GPIO_D1_5
			(PIN129 | FUNCTION_MODE4 | DRIVING_SELECTOR_2 | PULL_DOWN | SCHMITT_TRIGGER_DISABLE | SLEW_RATE_DISABLE)  // PIN_M36 GPIO_D1_6
			(PIN144 | FUNCTION_MODE4 | DRIVING_SELECTOR_2 | PULL_DOWN | SCHMITT_TRIGGER_DISABLE | SLEW_RATE_DISABLE)
			(PIN88 | FUNCTION_MODE0 | DRIVING_SELECTOR_2 | PULL_DOWN | SCHMITT_TRIGGER_DISABLE | SLEW_RATE_DISABLE)
			(PIN101 | FUNCTION_MODE0 | DRIVING_SELECTOR_2 | PULL_DOWN | SCHMITT_TRIGGER_DISABLE | SLEW_RATE_DISABLE)
			(PIN109 | FUNCTION_MODE5 | DRIVING_SELECTOR_2 | PULL_DOWN | SCHMITT_TRIGGER_DISABLE | SLEW_RATE_DISABLE) //1C19 GPIO_A1_6 TP2803FC_INT
			(PIN110 | FUNCTION_MODE0 | DRIVING_SELECTOR_2 | PULL_DOWN | SCHMITT_TRIGGER_DISABLE | SLEW_RATE_DISABLE)
		>;
		pb-msc-cfgs = <
			(PB_MSC_BIT0  | PB_MSC_REG_PIN_V33)  // PB085_086, PB089_092
			(PB_MSC_BIT1  | PB_MSC_REG_PIN_V33)  // PB093_098
			(PB_MSC_BIT2  | PB_MSC_REG_PIN_V33)  // PB102_107
			(PB_MSC_BIT3  | PB_MSC_REG_PIN_V33)  // PB111_116
			(PB_MSC_BIT4  | PB_MSC_REG_PIN_V33)  // PB117_121
			(PB_MSC_BIT5  | PB_MSC_REG_PIN_V18)  // PB002_025
			(PB_MSC_BIT6  | PB_MSC_REG_PIN_V18)  // PB026_049
			(PB_MSC_BIT7  | PB_MSC_REG_PIN_V18)  // PB050_081
			(PB_MSC_BIT8  | PB_MSC_REG_PIN_V18)  // PB082_083, PB140_143
			(PB_MSC_BIT9  | PB_MSC_REG_PIN_V18)  // PB084, PB087_088, PB099_101, PB108_110, PB122_139, PB144_174, PB192
			(PB_MSC_BIT10 | PB_MSC_REG_PIN_V18)  // PB175_191
		>;
	};
};
