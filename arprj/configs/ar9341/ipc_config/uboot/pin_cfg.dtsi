#include <dt-bindings/pinctrl/pinctrl-ar9301.h>

&soc {
	pinctrl {
		u-boot,dm-pre-reloc;
		compatible = "artosyn,ar9301-pinctrl";
		reg = <0x01073000 0x00000108	// pb_sw_reg_base
		       0x01073130 0x00000060>;	// pad_func_sel_base
		pinctrl-cfgs = <
			(PIN50 | FUNCTION_MODE1 | DRIVING_SELECTOR_2 | PULL_DOWN | SCHMITT_TRIGGER_DISABLE | SLEW_RATE_DISABLE)  // PIN_AL37 I2C4
			(PIN51 | FUNCTION_MODE1 | DRIVING_SELECTOR_2 | PULL_DOWN | SCHMITT_TRIGGER_DISABLE | SLEW_RATE_DISABLE)  // PIN_AK36 I2C4
			(PIN63 | FUNCTION_MODE0 | DRIVING_SELECTOR_2 | PULL_DOWN | SCHMITT_TRIGGER_DISABLE | SLEW_RATE_DISABLE)  // PIN_1Y13 JTAG0
			(PIN64 | FUNCTION_MODE0 | DRIVING_SELECTOR_2 | PULL_DOWN | SCHMITT_TRIGGER_DISABLE | SLEW_RATE_DISABLE)  // PIN_1V16 JTAG0
			(PIN66 | FUNCTION_MODE3 | DRIVING_SELECTOR_2 | PULL_DOWN | SCHMITT_TRIGGER_DISABLE | SLEW_RATE_DISABLE)  // PIN_1W14 SENSOR-MCLK0
			(PIN85 | FUNCTION_MODE2 | DRIVING_SELECTOR_2 | PULL_UP | SCHMITT_TRIGGER_DISABLE | SLEW_RATE_DISABLE)  // PIN_1R20 SD0
			(PIN86 | FUNCTION_MODE2 | DRIVING_SELECTOR_2 | PULL_UP | SCHMITT_TRIGGER_DISABLE | SLEW_RATE_DISABLE)  // PIN_1P20 SD0
			(PIN87 | FUNCTION_MODE2 | DRIVING_SELECTOR_2 | NO_PULL | SCHMITT_TRIGGER_DISABLE | SLEW_RATE_DISABLE)  // PIN_E36 SD0
			(PIN89 | FUNCTION_MODE2 | DRIVING_SELECTOR_2 | PULL_UP | SCHMITT_TRIGGER_DISABLE | SLEW_RATE_DISABLE)  // PIN_1P19 SD0
			(PIN90 | FUNCTION_MODE2 | DRIVING_SELECTOR_2 | PULL_UP | SCHMITT_TRIGGER_DISABLE | SLEW_RATE_DISABLE)  // PIN_1R19 SD0
			(PIN91 | FUNCTION_MODE2 | DRIVING_SELECTOR_2 | PULL_UP | SCHMITT_TRIGGER_DISABLE | SLEW_RATE_DISABLE)  // PIN_1R18 SD0
			(PIN92 | FUNCTION_MODE2 | DRIVING_SELECTOR_2 | PULL_UP | SCHMITT_TRIGGER_DISABLE | SLEW_RATE_DISABLE)  // PIN_1P18 SD0
			(PIN111 | FUNCTION_MODE2 | DRIVING_SELECTOR_2 | NO_PULL | SCHMITT_TRIGGER_DISABLE | SLEW_RATE_DISABLE)  // PIN_AG2 EMMC0
			(PIN112 | FUNCTION_MODE2 | DRIVING_SELECTOR_2 | PULL_UP | SCHMITT_TRIGGER_DISABLE | SLEW_RATE_DISABLE)  // PIN_AG1 EMMC0
			(PIN113 | FUNCTION_MODE2 | DRIVING_SELECTOR_2 | NO_PULL | SCHMITT_TRIGGER_DISABLE | SLEW_RATE_DISABLE)  // PIN_1R2 EMMC0
			(PIN114 | FUNCTION_MODE2 | DRIVING_SELECTOR_2 | PULL_UP | SCHMITT_TRIGGER_DISABLE | SLEW_RATE_DISABLE)  // PIN_AH1 EMMC0
			(PIN115 | FUNCTION_MODE2 | DRIVING_SELECTOR_2 | PULL_UP | SCHMITT_TRIGGER_DISABLE | SLEW_RATE_DISABLE)  // PIN_AH2 EMMC0
			(PIN116 | FUNCTION_MODE2 | DRIVING_SELECTOR_2 | PULL_UP | SCHMITT_TRIGGER_DISABLE | SLEW_RATE_DISABLE)  // PIN_1R3 EMMC0
			(PIN117 | FUNCTION_MODE2 | DRIVING_SELECTOR_2 | PULL_UP | SCHMITT_TRIGGER_DISABLE | SLEW_RATE_DISABLE)  // PIN_1U1 EMMC0
			(PIN118 | FUNCTION_MODE2 | DRIVING_SELECTOR_2 | PULL_UP | SCHMITT_TRIGGER_DISABLE | SLEW_RATE_DISABLE)  // PIN_1V1 EMMC0
			(PIN119 | FUNCTION_MODE2 | DRIVING_SELECTOR_2 | PULL_UP | SCHMITT_TRIGGER_DISABLE | SLEW_RATE_DISABLE)  // PIN_1U3 EMMC0
			(PIN120 | FUNCTION_MODE2 | DRIVING_SELECTOR_2 | PULL_UP | SCHMITT_TRIGGER_DISABLE | SLEW_RATE_DISABLE)  // PIN_1V2 EMMC0
			(PIN121 | FUNCTION_MODE2 | DRIVING_SELECTOR_2 | PULL_UP | SCHMITT_TRIGGER_DISABLE | SLEW_RATE_DISABLE)  // PIN_1U2 EMMC0
			(PIN149 | FUNCTION_MODE2 | DRIVING_SELECTOR_2 | PULL_UP | SCHMITT_TRIGGER_DISABLE | SLEW_RATE_DISABLE)  // PIN_T37 UART1
			(PIN150 | FUNCTION_MODE2 | DRIVING_SELECTOR_2 | PULL_UP | SCHMITT_TRIGGER_DISABLE | SLEW_RATE_DISABLE)  // PIN_U37 UART1
			(PIN151 | FUNCTION_MODE2 | DRIVING_SELECTOR_2 | NO_PULL | SCHMITT_TRIGGER_DISABLE | SLEW_RATE_DISABLE)  // PIN_U36 I2C0
			(PIN152 | FUNCTION_MODE2 | DRIVING_SELECTOR_2 | NO_PULL | SCHMITT_TRIGGER_DISABLE | SLEW_RATE_DISABLE)  // PIN_V36 I2C0
			(PIN156 | FUNCTION_MODE0 | DRIVING_SELECTOR_2 | PULL_UP | SCHMITT_TRIGGER_DISABLE | SLEW_RATE_DISABLE)    // PIN_Y37 GPIO_D0_0
			(PIN159 | FUNCTION_MODE0 | DRIVING_SELECTOR_2 | PULL_UP | SCHMITT_TRIGGER_DISABLE | SLEW_RATE_DISABLE)  // PIN_1L20 UART0
			(PIN160 | FUNCTION_MODE0 | DRIVING_SELECTOR_2 | PULL_UP | SCHMITT_TRIGGER_DISABLE | SLEW_RATE_DISABLE)  // PIN_1M20 UART0
			(PIN175 | FUNCTION_MODE2 | DRIVING_SELECTOR_2 | PULL_DOWN | SCHMITT_TRIGGER_DISABLE | SLEW_RATE_DISABLE)  // PIN_1P2 GMAC0
			(PIN176 | FUNCTION_MODE2 | DRIVING_SELECTOR_2 | PULL_DOWN | SCHMITT_TRIGGER_DISABLE | SLEW_RATE_DISABLE)  // PIN_1R1 GMAC0
			(PIN177 | FUNCTION_MODE2 | DRIVING_SELECTOR_2 | PULL_DOWN | SCHMITT_TRIGGER_DISABLE | SLEW_RATE_DISABLE)  // PIN_1P1 GMAC0
			(PIN178 | FUNCTION_MODE2 | DRIVING_SELECTOR_2 | PULL_DOWN | SCHMITT_TRIGGER_DISABLE | SLEW_RATE_DISABLE)  // PIN_AF2 GMAC0
			(PIN179 | FUNCTION_MODE2 | DRIVING_SELECTOR_2 | PULL_DOWN | SCHMITT_TRIGGER_DISABLE | SLEW_RATE_DISABLE)
			(PIN180 | FUNCTION_MODE2 | DRIVING_SELECTOR_2 | PULL_DOWN | SCHMITT_TRIGGER_DISABLE | SLEW_RATE_DISABLE)
			(PIN181 | FUNCTION_MODE2 | DRIVING_SELECTOR_2 | PULL_DOWN | SCHMITT_TRIGGER_DISABLE | SLEW_RATE_DISABLE)  // PIN_1M3 GMAC0
			(PIN182 | FUNCTION_MODE2 | DRIVING_SELECTOR_2 | PULL_DOWN | SCHMITT_TRIGGER_DISABLE | SLEW_RATE_DISABLE)  // PIN_1M2 GMAC0
			(PIN183 | FUNCTION_MODE2 | DRIVING_SELECTOR_2 | PULL_DOWN | SCHMITT_TRIGGER_DISABLE | SLEW_RATE_DISABLE)  // PIN_AD2 GMAC0
			(PIN184 | FUNCTION_MODE2 | DRIVING_SELECTOR_2 | PULL_DOWN | SCHMITT_TRIGGER_DISABLE | SLEW_RATE_DISABLE)  // PIN_AD1 GMAC0
			(PIN185 | FUNCTION_MODE2 | DRIVING_SELECTOR_2 | PULL_DOWN | SCHMITT_TRIGGER_DISABLE | SLEW_RATE_DISABLE)
			(PIN186 | FUNCTION_MODE2 | DRIVING_SELECTOR_2 | PULL_DOWN | SCHMITT_TRIGGER_DISABLE | SLEW_RATE_DISABLE)
			(PIN187 | FUNCTION_MODE2 | DRIVING_SELECTOR_2 | PULL_DOWN | SCHMITT_TRIGGER_DISABLE | SLEW_RATE_DISABLE)  // PIN_AB2 GMAC0
			(PIN188 | FUNCTION_MODE2 | DRIVING_SELECTOR_2 | PULL_DOWN | SCHMITT_TRIGGER_DISABLE | SLEW_RATE_DISABLE)  // PIN_AB1 GMAC0
			(PIN189 | FUNCTION_MODE2 | DRIVING_SELECTOR_2 | PULL_DOWN | SCHMITT_TRIGGER_DISABLE | SLEW_RATE_DISABLE)  // PIN_AA2 GMAC0
			(PIN190 | FUNCTION_MODE2 | DRIVING_SELECTOR_2 | PULL_DOWN | SCHMITT_TRIGGER_DISABLE | SLEW_RATE_DISABLE)  // PIN_Y2 GMAC0
			(PIN191 | FUNCTION_MODE2 | DRIVING_SELECTOR_2 | PULL_DOWN | SCHMITT_TRIGGER_DISABLE | SLEW_RATE_DISABLE)  // PIN_AA1 GMAC0
			// GPIO 
			(PIN5 | FUNCTION_MODE2 | DRIVING_SELECTOR_2 | PULL_DOWN | SCHMITT_TRIGGER_DISABLE | SLEW_RATE_DISABLE)  // PIN_B36 
			(PIN6 | FUNCTION_MODE2 | DRIVING_SELECTOR_2 | PULL_DOWN | SCHMITT_TRIGGER_DISABLE | SLEW_RATE_DISABLE)  // PIN_B37 
			(PIN7 | FUNCTION_MODE2 | DRIVING_SELECTOR_2 | PULL_UP | SCHMITT_TRIGGER_DISABLE | SLEW_RATE_DISABLE)  // PIN_A35 
			(PIN9 | FUNCTION_MODE2 | DRIVING_SELECTOR_2 | PULL_UP | SCHMITT_TRIGGER_DISABLE | SLEW_RATE_DISABLE)  // PIN_A34 
			(PIN80 | FUNCTION_MODE0 | DRIVING_SELECTOR_2 | PULL_DOWN | SCHMITT_TRIGGER_DISABLE | SLEW_RATE_DISABLE)  // PIN_1V7
			(PIN88 | FUNCTION_MODE0 | DRIVING_SELECTOR_2 | PULL_UP | SCHMITT_TRIGGER_DISABLE | SLEW_RATE_DISABLE)  // PIN_F36 
			(PIN123 | FUNCTION_MODE4 | DRIVING_SELECTOR_2 | PULL_DOWN | SCHMITT_TRIGGER_DISABLE | SLEW_RATE_DISABLE)  // PIN_1E17 
			(PIN124 | FUNCTION_MODE4 | DRIVING_SELECTOR_2 | PULL_DOWN | SCHMITT_TRIGGER_DISABLE | SLEW_RATE_DISABLE)  // PIN_1F17 
			(PIN125 | FUNCTION_MODE4 | DRIVING_SELECTOR_2 | PULL_DOWN | SCHMITT_TRIGGER_DISABLE | SLEW_RATE_DISABLE)  // PIN_1E18 
			(PIN126 | FUNCTION_MODE4 | DRIVING_SELECTOR_2 | PULL_DOWN | SCHMITT_TRIGGER_DISABLE | SLEW_RATE_DISABLE)  // PIN_1F19 
			(PIN127 | FUNCTION_MODE4 | DRIVING_SELECTOR_2 | PULL_DOWN | SCHMITT_TRIGGER_DISABLE | SLEW_RATE_DISABLE)  // PIN_L36 
			(PIN128 | FUNCTION_MODE4 | DRIVING_SELECTOR_2 | PULL_DOWN | SCHMITT_TRIGGER_DISABLE | SLEW_RATE_DISABLE)  // PIN_L37 
			(PIN130 | FUNCTION_MODE4 | DRIVING_SELECTOR_2 | PULL_DOWN | SCHMITT_TRIGGER_DISABLE | SLEW_RATE_DISABLE)  // PIN_N36 
			(PIN131 | FUNCTION_MODE4 | DRIVING_SELECTOR_2 | PULL_DOWN | SCHMITT_TRIGGER_DISABLE | SLEW_RATE_DISABLE)  // PIN_N37 
			(PIN132 | FUNCTION_MODE4 | DRIVING_SELECTOR_2 | PULL_DOWN | SCHMITT_TRIGGER_DISABLE | SLEW_RATE_DISABLE)  // PIN_P36 
			(PIN134 | FUNCTION_MODE4 | DRIVING_SELECTOR_2 | PULL_DOWN | SCHMITT_TRIGGER_DISABLE | SLEW_RATE_DISABLE)  // PIN_1J18 
			(PIN136 | FUNCTION_MODE4 | DRIVING_SELECTOR_2 | PULL_UP | SCHMITT_TRIGGER_DISABLE | SLEW_RATE_DISABLE)  // PIN_1J19 
			(PIN137 | FUNCTION_MODE4 | DRIVING_SELECTOR_2 | PULL_UP | SCHMITT_TRIGGER_DISABLE | SLEW_RATE_DISABLE)  // PIN_1H19 
			(PIN167 | FUNCTION_MODE0 | DRIVING_SELECTOR_2 | PULL_DOWN | SCHMITT_TRIGGER_DISABLE | SLEW_RATE_DISABLE)  // PIN_AC36 
		>;
        pb-msc-cfgs = <
		
                (PB_MSC_BIT0 | PB_MSC_REG_PIN_V33)  // PB085_086, PB089_092
                (PB_MSC_BIT1 | PB_MSC_REG_PIN_V18)  // PB093_098
                (PB_MSC_BIT2 | PB_MSC_REG_PIN_V18)  // PB102_107
                (PB_MSC_BIT3 | PB_MSC_REG_PIN_V33)  // PB111_116
                (PB_MSC_BIT4 | PB_MSC_REG_PIN_V33)  // PB117_121
                (PB_MSC_BIT5 | PB_MSC_REG_PIN_V33)  // PB002_025
                (PB_MSC_BIT6 | PB_MSC_REG_PIN_V18)  // PB026_049
                (PB_MSC_BIT7 | PB_MSC_REG_PIN_V18)  // PB050_081
                (PB_MSC_BIT8 | PB_MSC_REG_PIN_V33)  // PB082_083, PB140_143
                (PB_MSC_BIT9 | PB_MSC_REG_PIN_V33)  // PB084, PB087_088, PB099_101, PB108_110, PB122_139, PB144_174, PB192
                (PB_MSC_BIT10 | PB_MSC_REG_PIN_V33)  // PB175_191
        >;
	};
};
