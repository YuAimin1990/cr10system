#include <dt-bindings/clock/ar9301-cgu.h>

&soc {
	cgu: cgu@01070000{
		u-boot,dm-pre-reloc;
		compatible = "artosyn,ar9301-cgu";
		reg = <0x01070000 0x00001000	// cgu
		       0x01072000 0x00001000	// abb
		       0x01074000 0x00000140	// top_reg
		       0x010c0000 0x00000020	// ceva_cgu
		       0x010e0000 0x00000040>;	// a53_cgu

		abb-freqs = <50000000	// abb_emmc_freq      50MHz
			     50000000	// abb_sdc0_freq      50MHz
			     50000000	// abb_sdc1_freq      50MHz
			     600000000	// abb_pixel_freq    600MHz
			     40000000 	// abb_audio_freq     40MHz
			     74250000 	// abb_audio1_freq 74.25MHz
			     27000000	// abb_audio2_freq    27MHz
			     40000000	// abb_backup_freq    40MHz
			     500000000	// abb_a53_freq      500MHz
			     500000000	// abb_ceva_freq     500MHz
			     500000000>;// abb_dla_freq      500MHz

		clk-default-gating = <(CLK_CFG_CS	| ON)
				      (CLK_CORE_CS	| ON)
				      (CLK_CFG_HDECOMP	| ON)
				      (CLK_CORE_HDECOMP	| ON)
				      (CLK_CFG_TOPDMAC	| ON)
				      (CLK_AXI_TOPDMAC	| ON)
				      (CLK_CORE_TOPDMAC	| ON)
				      (CLK_CFG_EMMC	| ON)
				      (CLK_EMMC_CARDCLK	| ON)
				      (CLK_CFG_SEC	| ON)
				      (CLK_CFG_EFUSE	| ON)
				      (CLK_CFG_ROM	| ON)
				      (CLK_CFG_SPIDBG	| ON)
				      (CLK_150_NOC_G0	| ON)
				      (CLK_CFG_ISP	| ON)
				      (CLK_ISP		| ON)
				      (CLK_AXI_VIF	| ON)
				      (CLK_HDR		| ON)
				      (CLK_CFG_SCALER	| ON)
				      (CLK_SCALER	| ON)
				      (CLK_CFG_JPEG	| ON)
				      (CLK_CORE_JPEG	| ON)
				      (CLK_CFG_DISP	| ON)
				      (CLK_CORE_DISP	| ON)
				      (CLK_150_NOC_G1	| ON)
				      (CLK_CFG_CEVA	| ON)
				      (CLK_150_NOC_G2	| ON)
				      (CLK_CFG_DLA	| ON)
				      (CLK_CFG_VENC	| ON)
				      (CLK_AXI_VENC	| ON)
				      (CLK_BPU_VENC	| ON)
				      (CLK_150_NOC_G3	| ON)
				      (CLK_150_NOC_G4	| ON)
				      (CLK_PIXEL_DISP	| ON)
				      (CLK_PATTERN_GEN	| ON)
				      (CLK_SUB_1_1X_PIX	| ON)
				      (CLK_DVP_PIX_HLY	| ON)
				      (CLK_SUB_1_2X_PIX	| ON)
				      (CLK_DVP_PIX	| ON)
				      (CLK_DSI_PIX	| ON)
				      (CLK_CFG_DDR	| ON)
				      (CLK_DDR		| ON)
				      (CLK_CFG_MIPI	| ON)
				      (CLK_VIDEO_MIPI0	| ON)
				      (CLK_VIDEO_MIPI1	| ON)
				      (CLK_VIDEO_MIPI2	| ON)
				      (CLK_VIDEO_MIPI3	| ON)
				      (CLK_PCS_MIPI	| ON)
				      (CLK_CFG_DSI	| ON)
				      (CLK_CFG_VIF	| ON)
				      (CLK_CFG_DVPCTL	| ON)
				      (CLK_CFG_USB2OTG0	| ON)
				      (CLK_PHY_USB2PHY0	| ON)
				      (CLK_CFG_USB2OTG1	| ON)
				      (CLK_PHY_USB2PHY1	| ON)
				      (CLK_CFG_USB2OTG2	| ON)
				      (CLK_PHY_USB2PHY2	| ON)
				      (CLK_150_NOC_G5	| ON)
				      (CLK_CFG_GMAC	| ON)
				      (CLK_CORE_GMAC	| ON)
				      (CLK_PHY_GMAC	| ON)
				      (CLK_CCI		| ON)
				      (CLK_SRAM		| ON)
				      (CLK_600_NOC	| ON)
				      (CLK_SENSOR0	| ON)
				      (CLK_SENSOR1	| ON)
				      (CLK_SENSOR2	| ON)
				      (CLK_SENSOR3	| ON)
				      (CLK_CORE_PERIP	| ON)
				      (CLK_AUDIO_300M	| ON)
				      (CLK_AUDIO_ADC	| ON)
				      (CLK_PERIP_I2SM	| ON)
				      (CLK_SDC_FIXED	| ON)
				      (CLK_SDC_SAMPLE	| ON)
				      (CLK_SDC_DRV	| ON)
				      (CLK_CORE_QSPI	| ON)>;
			clk-default-sel = <(CLK_CORE_TOPDMAC	| CLK_CORE_TOPDMAC_CLK500M)
					   (CLK_ISP		| CLK_ISP_CLK666M)
					   (CLK_AXI_VIF		| CLK_AXI_VIF_CLK666M)
					   (CLK_HDR		| CLK_HDR_CLK666M)
					   (CLK_SCALER		| CLK_SCALER_CLK666M)
					   (CLK_CORE_JPEG	| CLK_CORE_JPEG_CLK666M)
					   (CLK_CORE_DISP	| CLK_CORE_DISP_CLK666M)
					   (CLK_AXI_VENC	| CLK_AXI_VENC_CLK666M)
					   (CLK_BPU_VENC	| CLK_BPU_VENC_CLK666M)
					   (CLK_PIXEL_DISP	| CLK_PIXEL_DISP_CLKPIXEL_DIV2)
					   (CLK_DSI_PIX		| CLK_DSI_PIX_CLKPIXEL_DIV2)
					   (CLK_PCS_MIPI	| CLK_PCS_MIPI_CLK333M)
					   (CLK_CFG_GMAC	| CLK_CFG_GMAC_CLK150M_DIV2)
					   (CLK_PHY_GMAC	| CLK_PHY_GMAC_CLK25M)
					   (CLK_SENSOR0		| CLK_SENSOR0_CLK_SENSOR_1_DIV2)
					   (CLK_SENSOR1		| CLK_SENSOR1_CLK_SENSOR_1_DIV2)
					   (CLK_SENSOR2		| CLK_SENSOR2_CLK_SENSOR_1_DIV2)
					   (CLK_SENSOR3		| CLK_SENSOR3_CLK_SENSOR_1_DIV2)
					// (CLK_SDC_DRV		| CLK_SELECT_1)
					   (CLK_CORE_QSPI	| CLK_CORE_QSPI_CLK400M)
					// (I2S_MST0_DIV	| CLK_SELECT_1)
					// (I2S_MST1_DIV	| CLK_SELECT_1)
					// (I2S_MST2_DIV	| CLK_SELECT_1)
					   (CLK_PERIP_I2SM	| CLK_PERIP_I2SM_CLKAUDIO_DIV2)>;
	};
};
