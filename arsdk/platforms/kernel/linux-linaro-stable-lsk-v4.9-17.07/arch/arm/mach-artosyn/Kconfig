## arsdk/platforms/kernel/linux-linaro-stable-lsk-v4.9-17.07/arch/arm/mach-artosyn/Kconfig
```kconfig
menuconfig ARCH_ARTOSYN
	bool "Artosyn SoCs"  # if ARCH_MULTI_V7
	select ARCH_REQUIRE_GPIOLIB
	select ARCH_HAS_RESET_CONTROLLER
	select CLKSRC_MMIO
	select GENERIC_IRQ_CHIP
	select PINCTRL
	select RESET_CONTROLLER
	select INLINE_SPIN_UNLOCK_IRQ
if ARCH_ARTOSYN

config MACH_SIRIUS
	bool "Artosyn Sirius SoCs support"
	default ARCH_ARTOSYN
	select ARM_GIC
	select DW_APB_TIMER_OF

config SIRIUS_FPGA_SIMULATION
	bool "Select if you are running on a FPGA platform"
endif
```

## arsdk/platforms/kernel/linux-linaro-stable-lsk-v4.9-17.07/drivers/ar_dvfs/Kconfig
```kconfig
config ARTOSYN_DVFS
	tristate "DVFS for artosyn"
	help
	  Choose this option if you wish to use dvfs on artosyn Platform.
```

## arsdk/platforms/kernel/linux-linaro-stable-lsk-v4.9-17.07/drivers/clk/artosyn/Kconfig
```kconfig
config CLK_AR9301
	bool "Artosyn AR9301 clock unit support"
	depends on ARM64
	default n
	help
		Build the driver for AR9301 Clock Driver

config CLK_AR9311
	bool "Artosyn AR9311 clock unit support"
	depends on ARM64
	default n
	help
		Build the driver for AR9311 Clock Driver
```

## arsdk/platforms/kernel/linux-linaro-stable-lsk-v4.9-17.07/drivers/net/can/artosyn/Kconfig
```kconfig
config CAN_AR9201
	tristate "Artosyn AR9201 can devices"
	depends on ARCH_ARTOSYN || ARM || ARM64
	---help---
	  Say Y here if you want to use CAN controller found on Artosyn ar9201
	  SoCs.
```

## arsdk/platforms/kernel/linux-linaro-stable-lsk-v4.9-17.07/drivers/net/ethernet/artosyn/Kconfig
```kconfig
config SIRIUS_ETH
	tristate "Sirius Ethernet support"
	select CRC32
	select MII
	select PHYLIB
	default y

config SIRIUS_ETH_BASIC_FEATURES
	bool "Disable Gigabit Ethernet Features"
	depends on SIRIUS_ETH
	---help---
	  Do not advertise 1000BT capabilities during auto negotiation process,
	  even if supported by ethernet core.
```

## arsdk/platforms/kernel/mods/linux-linaro-stable-lsk-v4.9-17.07/drivers/ar_icc/Kconfig
```kconfig
config ARTOSYN_ICC
	tristate "Icc for artosyn"
	help
	  Choose this option if you wish to use icc on artosyn Platform.
```

## arsdk/platforms/kernel/mods/linux-linaro-stable-lsk-v4.9-17.07/drivers/media/platform/ar_cam/Kconfig
```kconfig
config VIDEO_ARTOSYN_CAM
        tristate "Artosyn camera support"
        depends on ARCH_ARTOSYN
        #select VIDEOBUF2_DMA_CONTIG
	#select VIDEOBUF2_VMALLOC
	select VIDEOBUF2_CORE
	#select ARTOSYN_CAM_RPC
	#select ARTOSYN_CAM_RPC_API
	#select ARTOSYN_CAM_RPC_LOG
	#select ARTOSYN_CAM_RPC_DEBUG
        ---help---
          This is a v4l2 driver for Artosyn Sirius camera

config ARTOSYN_CAM_RPC
	bool "Artosyn camera RPC"
#	#depends on VIDEO_ARTOSYN_CAM
#	---help---
#	  The RPC for Artosyn camera, must select
#
config ARTOSYN_CAM_RPC_API
	bool "Artosyn camera RPC API"
#	#depends on ARTOSYN_CAM_RPC
#	---help---
#	  Artosyn RPC API support for cameras
#
config ARTOSYN_CAM_RPC_LOG
	bool "Artosyn camera RPC log"
#	depends on ARTOSYN_CAM_RPC
#	---help---
#	  Artosyn logs support for camera
#
config ARTOSYN_CAM_RPC_DEBUG
	bool "Artosyn camera RPC debugfs support"
#	#depends on ARTOSYN_CAM_RPC
#	---help---
#	  Artosyn RPC debugfs support for camera
```

## arsdk/platforms/kernel/mods/linux-linaro-stable-lsk-v4.9-17.07/drivers/pci/dwc/Kconfig
```kconfig
menu "DesignWare PCI Core Support"

config PCIE_DW
    bool

config PCIE_DW_HOST
    bool
    depends on PCI
    depends on PCI_MSI_IRQ_DOMAIN
    select PCIE_DW

config PCIE_DW_EP
    bool
    depends on PCI_ENDPOINT
    select PCIE_DW

config PCIE_DW_PLAT
	bool "Platform bus based DesignWare PCIe Controller"
	depends on PCI
	depends on PCI_MSI_IRQ_DOMAIN
	select PCIE_DW_HOST
	---help---
	 This selects the DesignWare PCIe controller support. Select this if
	 you have a PCIe controller on Platform bus.

	 If you have a controller with this interface, say Y or M here.

	 If unsure, say N.

config PCI_AR91XX
    bool "AR PCIe controller"
    depends on (PCI && PCI_MSI_IRQ_DOMAIN) || PCI_ENDPOINT
    help
        Artosyn DUAL role PCIe controller. In order to enable host-specific features PCI_AR91XX_HOST must be selected and in order to enable device-specific features PCI_AR91XX_EP must be selected. This uses the Designware core.

if PCI_AR91XX

config PCI_AR91XX_HOST
    bool "PCI AR91XX Host Mode"
    depends on PCI
    depends on PCI_MSI_IRQ_DOMAIN
    select PCIE_DW_HOST
    default y
    help
        Enables support for the PCIe controller in the AR91XX SoC to work in host mode.

config PCI_AR91XX_EP
    bool "PCI AR91XX Endpoint Mode"
    depends on PCI_ENDPOINT
    select PCIE_DW_EP
    help
        Enables support for the PCIe controller in the AR91XX SoC to work in endpoint mode.

endif

endmenu
```

## arsdk/platforms/kmodule/ar_framebuffer/Kconfig
```kconfig
#
# Artosyn Display Support
#
menuconfig AR_FRAMEBUFFER
	bool "Artosyn Display Support"
    default y
	help
	   Driver of display.
```

## arsdk/platforms/kmodule/ar_gdc/Kconfig
```kconfig
#
# Artosyn GDC Support
#
menuconfig AR_GDC_DRV
	bool "Driver for AR GDC module"
    default n
	help
	   Enable the driver for AR GDC
```

## arsdk/platforms/kmodule/ar_ifc/Kconfig
```kconfig
#
# Artosyn IFC Support
#
menuconfig AR_IFC_DRV
	bool "Driver for AR Image Format Converter"
    default y
	help
	   Enable the driver for AR IFC
```

## arsdk/platforms/kmodule/ar_npu/Kconfig
```kconfig
#
# Artosyn Display Support
#
menuconfig AR_NPU_DRV
	bool "Driver for ar Deep Learning Accelerator"
    default y
	help
	   Enable the driver for AR NPU
```

## arsdk/platforms/kmodule/ar_scaler/Kconfig
```kconfig
#
# Artosyn Scaler Support
#
menuconfig AR_SCALER_DRV
	bool "Driver for AR Scaler module"
    default y
	help
	   Enable the driver for AR Scaler
```

## arsdk/platforms/uboot/mods/u-boot-2020.10/drivers/ram/artosyn/Kconfig
```kconfig
choice
	prompt "Artosyn SDRAM drivers"
	default AR93XX_SDRAM_DDR4
	help
	  There is several DDR type supported by ARTOSYN, choose
	  one to work.

config AR93XX_SDRAM_DDR4
	bool "DDR4"
	help
	  Enable DDR4 driver.

config AR93XX_SDRAM_DDR3
	bool "DDR3"
	help
	  Enable DDR3 driver.
endchoice
```

## arsdk/platforms/uboot/u-boot-2020.10/arch/arm/mach-artosyn/Kconfig
```kconfig
if ARCH_ARTOSYN

config ARTOSYN_AR9301
	bool "Support Artosyn 9301"
	select ARM64
	select SUPPORT_SPL
	select SPL
	imply SPL_SEPARATE_BSS
	select SPL_SERIAL_SUPPORT
	select DEBUG_UART_BOARD_INIT
	help
	  The Artosyn 9301 is a ARM-based SoC with a quad-core Cortex-A53
	  including NEON several DDR4 options
	  and video codec support. Peripherals include Gigabit Ethernet,
	  USB2 host and OTG, SDIO, I2S, UART, SPI, I2C and PWMs.

config ARTOSYN_AR9311
	bool "Support Artosyn 9311"
	select ARM64
	select SUPPORT_SPL
	select SPL
	imply SPL_SEPARATE_BSS
	select SPL_SERIAL_SUPPORT
	select DEBUG_UART_BOARD_INIT
	help
	  The Artosyn 9311 is a ARM-based SoC with a dual-core Cortex-A53
	  including NEON several DDR4 options
	  and video codec support. Peripherals include Gigabit Ethernet,
	  USB2 host and OTG, SDIO, I2S, UART, SPI, I2C and PWMs.

config SYS_VENDOR
	default "artosyn"

source arch/arm/mach-artosyn/ar9301/Kconfig
source arch/arm/mach-artosyn/ar9311/Kconfig

endif
```

## arsdk/platforms/uboot/u-boot-2020.10/arch/arm/mach-artosyn/ar9311/Kconfig
```kconfig
if ARTOSYN_AR9311

choice
	prompt "Artosyn 9311 SoC Board select"
	default TARGET_EVB_AR9311

config TARGET_EVB_AR9311
	bool "Artosyn AR9311 EVB"

config TARGET_VELOCE_AR9311
	bool "AR9311 on veloce platform"

config TARGET_FPGA_AR9311
	bool "AR9311 on fpga platform"

config TARGET_QEMU_AR9311
	bool "AR9311 on qemu platform"

endchoice

config ARTOSYN_BOOT_MODE_REG
	default 0xff010200

config SYS_SOC
	default "ar9311"

config SYS_MALLOC_F_LEN
	default 0x400

config SPL_SERIAL_SUPPORT
	default y

config DEBUG_UART_CHANNEL
	int "Mux channel to use for debug UART2/UART3"
	depends on DEBUG_UART_BOARD_INIT
	default 0
	help
	  UART2 and UART3 can use two different set of pins to route the output.
	  For using the UART for early debugging the route to use needs
	  to be declared (0 or 1).

source "board/artosyn/evb_ar9311/Kconfig"

endif
```

## arsdk/platforms/uboot/u-boot-2020.10/drivers/gicv2/Kconfig
```kconfig
#menu "GICV2 Support"

config GICV2_AR
	bool "artosyn gicv2 driver"
	default y
	help
		gicv2 driver

#endmenu # menu "GICV2 Support"
```
